// SPDX-License-Identifier: (GPL-2.0-or-later OR MIT)
/*
 * Copyright (c) 2023 Da Xue <da@libre.computer>
 * Author: Da Xue <da@libre.computer>
 */
/*
 * Summary: 40P GPIO
 *
 * Pins (Header.Pin  Name  Pad  Ref — cross-ref gpio.map):
 *   7J1.22   PA14          G12     UART3-RX
 *   7J1.32   PA13          E15     UART3-TX
 *   7J1.36   PA15          F14     UART3-RTS
 *   7J1.37   PA16          D15     UART3-CTS
 */
/dts-v1/;
/plugin/;

/ {
	compatible = "libre-computer,all-h3-cc-h3",
		"libretech,all-h3-cc-h3",
		"libre-computer,all-h3-cc-h5",
		"libretech,all-h3-cc-h5",
		"allwinner,sun8i-h3",
		"allwinner,sun50i-h5";

	fragment@0 {
		target = <&uart3>;

		__overlay__ {
			pinctrl-names = "default";
			pinctrl-0 = <&uart3_pins>, <&uart3_rts_cts_pins>;
			uart-has-rtscts;
			status = "okay";
		};
	};
};

