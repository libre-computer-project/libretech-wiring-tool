// SPDX-License-Identifier: (GPL-2.0+ OR MIT)
/*
 * Copyright (c) 2023 Da Xue <da@libre.computer>
 * Author: Da Xue <da@libre.computer>
 */

/* 40P GPIO
 * Pin 7 RTS
 * Pin 11 RX
 * Pin 13 TX
 * Pin 15 CTS
 */

/dts-v1/;
/plugin/;

/ {
	compatible = "libretech,all-h3-cc-h5", "libretech,all-h3-cc-h3", "allwinner,sun50i-h5", "allwinner,sun8i-h3";

	fragment@0 {
		target = <&uart2>;

		__overlay__ {
			pinctrl-names = "default";
			pinctrl-0 = <&uart2_pins>, <&uart2_rts_cts_pins>;
			uart-has-rtscts;
			status = "okay";
		};
	};
};

