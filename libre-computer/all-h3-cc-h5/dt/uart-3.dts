// SPDX-License-Identifier: (GPL-2.0-or-later OR MIT)
/*
 * Copyright (c) 2023 Da Xue <da@libre.computer>
 * Author: Da Xue <da@libre.computer>
 */
/* 40P GPIO
 * Pin 22 RX
 * Pin 32 TX
 */

/dts-v1/;
/plugin/;

/ {
	compatible = "libre-computer,all-h3-cc-h3",
		"libretech,all-h3-cc-h3",
		"libre-computer,all-h3-cc-h5",
		"libretech,all-h3-cc-h5",
		"allwinner,sun8i-h3",
		"allwinner,sun50i-h5";

	fragment@0 {
		target = <&uart3>;

		__overlay__ {
			pinctrl-names = "default";
			pinctrl-0 = <&uart3_pins>;
			status = "okay";
		};
	};
};

