// SPDX-License-Identifier: (GPL-2.0-or-later OR MIT)
/*
 * Copyright (c) 2023 Da Xue <da@libre.computer>
 * Author: Da Xue <da@libre.computer>
 */
/*
 * Summary: 40P GPIO
 *
 * Pins (Header.Pin  Name  Pad  Ref — cross-ref gpio.map):
 *   7J1.8    PG6           G4      AP-UART1-TX
 *   7J1.10   PG7           D3      AP-UART1-RX
 *   7J1.16   PG9           D3      AP-UART1-CTS
 *   7J1.18   PG8           C3      AP-UART1-RTS
 */
/dts-v1/;
/plugin/;

/ {
	compatible = "libre-computer,all-h3-cc-h3",
		"libretech,all-h3-cc-h3",
		"libre-computer,all-h3-cc-h5",
		"libretech,all-h3-cc-h5",
		"allwinner,sun8i-h3",
		"allwinner,sun50i-h5";

	fragment@0 {
		target = <&uart1>;

		__overlay__ {
			pinctrl-names = "default";
			pinctrl-0 = <&uart1_pins>, <&uart1_rts_cts_pins>;
			uart-has-rtscts;
			status = "okay";
		};
	};
};

