// SPDX-License-Identifier: (GPL-2.0-or-later OR MIT)
/*
 * Copyright (c) 2026 Da Xue <da@libre.computer>
 * Author: Da Xue <da@libre.computer>
 */
/*
 * Summary: I2S0 on 40P header 7J1 pins 27 (BCLK), 28 (LRCK), 29 (DOUT), 31 (DIN)
 *
 * Pins (Header.Pin  Name  Pad  Ref — cross-ref gpio.map):
 *   7J1.27   PA19          B14     I2S0-SCLK
 *   7J1.28   PA18          B13     I2S0-LRCK
 *   7J1.29   PA20          A13     I2S0-SDO
 *   7J1.31   PA21          A14     I2S0-SDI
 */
/dts-v1/;
/plugin/;

/ {
	compatible = "libre-computer,all-h3-cc-h3",
		"libretech,all-h3-cc-h3",
		"libre-computer,all-h3-cc-h5",
		"libretech,all-h3-cc-h5",
		"allwinner,sun8i-h3",
		"allwinner,sun50i-h5";

	/*
	 * Mainline sunxi-h3-h5.dtsi defines no I2S pin group, so the overlay
	 * carries its own: PA18..PA21 = SYNC, CLK, DOUT, DIN on mux "i2s0" in
	 * both pinctrl-sun8i-h3.c and pinctrl-sun50i-h5.c.
	 */
	fragment@0 {
		target = <&pio>;
		__overlay__ {
			i2s0_pins: i2s0-pins {
				pins = "PA18", "PA19", "PA20", "PA21";
				function = "i2s0";
			};
		};
	};

	fragment@1 {
		target = <&i2s0>;
		__overlay__ {
			pinctrl-names = "default";
			pinctrl-0 = <&i2s0_pins>;
			status = "okay";
		};
	};
};
