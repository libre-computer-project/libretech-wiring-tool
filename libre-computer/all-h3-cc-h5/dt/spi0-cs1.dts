/dts-v1/;
/plugin/;

#include <dt-bindings/gpio/gpio.h>

/ {
	compatible = "allwinner,sun50i-h5";

	fragment@0 {
		target = <&pio>;
		__overlay__ {
			spi0_cs1: spi0_cs1 {
				pins = "PA17";
				function = "gpio_out";
				output-high;
			};
		};
	};

	fragment@1 {
		target = <&spi0>;
		__overlay__ {
			status = "okay";
			pinctrl-names = "default", "default";
			pinctrl-1 = <&spi0_cs1>;
			cs-gpios = <0>, <&pio 0 17 GPIO_ACTIVE_LOW>;
		};
	};
};
