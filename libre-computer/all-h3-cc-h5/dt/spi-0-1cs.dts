// SPDX-License-Identifier: (GPL-2.0-or-later OR MIT)
/*
 * Copyright (c) 2023 Da Xue <da@libre.computer>
 * Author: Da Xue <da@libre.computer>
 */
/*
 * Summary: 40P GPIO
 *
 * Pins (Header.Pin  Name  Pad  Ref — cross-ref gpio.map):
 *   7J1.19   PC0           C15     SPI0-MOSI
 *   7J1.21   PC1           C16     SPI0-MISO
 *   7J1.23   PC2           B16     SPI0-CLK
 *   7J1.24   PC3           B15     SPI0-CS
 */
/dts-v1/;
/plugin/;

/ {
	compatible = "libre-computer,all-h3-cc-h3",
		"libretech,all-h3-cc-h3",
		"libre-computer,all-h3-cc-h5",
		"libretech,all-h3-cc-h5",
		"allwinner,sun8i-h3",
		"allwinner,sun50i-h5";

	fragment@0 {
		target-path = "/aliases";
		__overlay__ {
			spi0 = "/soc/spi@01c68000";
		};
	};

	fragment@1 {
		target = <&spi0>;
		__overlay__ {
			pinctrl-names = "default";
			status = "okay";
			cs-gpios = <0>;
		};
	};
};
