// SPDX-License-Identifier: (GPL-2.0-or-later OR MIT)
/*
 * Copyright (c) 2026 Da Xue <da@libre.computer>
 * Author: Da Xue <da@libre.computer>
 */
/*
 * Summary: 40P GPIO
 *
 * Pins (Header.Pin  Name  Pad  Ref — cross-ref gpio.map):
 *   7J1.12   PG11          D2      BB-PCM-CLK
 *   7J1.35   PG10          M3      BB-PCM-SYNC
 *   7J1.38   PG13          B1      BB-PCM-DIN
 *   7J1.40   PG12          D1      BB-PCM-DOUT
 */
/dts-v1/;
/plugin/;

/ {
	compatible = "libre-computer,all-h3-cc-h3",
		"libretech,all-h3-cc-h3",
		"libre-computer,all-h3-cc-h5",
		"libretech,all-h3-cc-h5",
		"allwinner,sun8i-h3",
		"allwinner,sun50i-h5";

	fragment@0 {
		target = <&i2s1>;
		__overlay__ {
			pinctrl-names = "default";
			pinctrl-0 = <&i2s1_pins>;
			status = "okay";
		};
	};
};
