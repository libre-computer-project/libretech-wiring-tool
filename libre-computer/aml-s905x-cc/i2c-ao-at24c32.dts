/*
 * Copyright (c) 2017 BayLibre, SAS.
 * Author: Thomas Rohloff <v10lator@myway.de>
 *
 * SPDX-License-Identifier: (GPL-2.0+ OR MIT)
 */

/*
 * Overlay aimed to add an AT24C32 EEPROM module on I2C_AO bus, address 0x57.
 */

/dts-v1/;
/plugin/;

/ {
	compatible = "libretech,cc", "amlogic,s905x", "amlogic,meson-gxl";

	fragment@1 {
		target = <&i2c_AO>;
		
		__overlay__ {
			eeprom@57 {
				compatible = "at,24c32";
				reg = <0x57>;
			};
		};
	};
};
