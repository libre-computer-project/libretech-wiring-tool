/*
 * Copyright (c) 2017 BayLibre, SAS.
 * Author: Neil Armstrong <narmstrong@baylibre.com>
 *
 * SPDX-License-Identifier: (GPL-2.0+ OR MIT)
 */

/*
 * Overlay aimed to enable I2C_AO on Header 7J1 :
 * Pins 3 (SDA), 5 (SCL)
 */

/dts-v1/;
/plugin/;

/ {
	compatible = "libretech,cc", "amlogic,s905x", "amlogic,meson-gxl";

	fragment@0 {
		target-path = "/aliases";

		__overlay__ {
			i2c1 = "/soc/aobus@c8100000/i2c@500";
		};
	};


	fragment@1 {
		target = <&i2c_AO>;
		
		__overlay__ {
			status = "okay";
			pinctrl-0 = <&i2c_ao_pins>;
			pinctrl-names = "default";
		};
	};
};
