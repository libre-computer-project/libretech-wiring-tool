/*
 * Copyright (c) 2017 BayLibre, SAS.
 * Author: Neil Armstrong <narmstrong@baylibre.com>
 *
 * SPDX-License-Identifier: (GPL-2.0+ OR MIT)
 */

/*
 * Overlay aimed to add an DS3231 RTC module on I2C_AO bus, address 0x68.
 */

/dts-v1/;
/plugin/;

/ {
	compatible = "libretech,cc", "amlogic,s905x", "amlogic,meson-gxl";

	fragment@1 {
		target = <&i2c_AO>;
		
		__overlay__ {
			rtc@68 {
				compatible = "maxim,ds3231";
				reg = <0x68>;
			};
		};
	};
};
