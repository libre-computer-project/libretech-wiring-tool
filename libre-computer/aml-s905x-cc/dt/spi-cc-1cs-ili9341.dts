// SPDX-License-Identifier: (GPL-2.0-or-later OR MIT)
/*
 * Copyright (c) 2018 BayLibre, SAS.
 * Author: Neil Armstrong <narmstrong@baylibre.com>
 */
/*
 * Summary: The Ilitek ILI9341 based panels such as the
 *
 * Pins (Header.Pin  Name  Pad  Ref — cross-ref gpio.map):
 *   7J1.19   GPIOX_8       B4      BTPCM_DOUT
 *   7J1.21   GPIOX_9       B3      BTPCM_DIN
 *   7J1.23   GPIOX_11      C4      BTPCM_CLK
 *   7J1.24   GPIOX_10      C5      BTPCM_SYNC
 *   7J1.29   GPIOX_17      B5      BT_EN
 *   7J1.31   GPIOX_18      B7      BT_WAKE_HOST
 *
 * Requires: spi-cc-1cs
 *
 * Notes:
 *   Display stack: tinydrm (DRM tiny / panel) preferred; staging fbtft is the
 *   legacy fallback when both are built. Compatible order is tinydrm-first.
 *   Properties tagged "fbtft/legacy" are ignored by tinydrm (CONFIG_FB_TFT_* only).
 *   - Adafruit 2.2" SPI display
 *   - Adafruit 2.8" Touch Shield V2 (SPI)
 *   - Adafruit 2.4" TFT LCD with Touchscreen Breakout w/MicroSD Socket
 *   - Adafruit 2.8" TFT LCD with Touchscreen Breakout Board w/MicroSD Socket
 *   - Adafruit 2.2" 18-bit color TFT LCD display with microSD card breakout
 *   - Adafruit TFT FeatherWing - 2.4" 320x240 Touchscreen For All Feathers
 */
/dts-v1/;
/plugin/;

#include <dt-bindings/gpio/gpio.h>
#include <dt-bindings/gpio/meson-gxl-gpio.h>

/ {
	compatible = "libre-computer,aml-s905x-cc",
		"libretech,aml-s905x-cc",
		"libre-computer,aml-s905x-cc-v2",
		"libretech,aml-s905x-cc-v2",
		"libre-computer,aml-s905x-cc-v3",
		"libretech,aml-s905x-cc-v3",
		"amlogic,s905x",
		"amlogic,meson-gxl";

	fragment@0 {
		target = <&spicc>;
		
		__overlay__ {
			/*
			 * The display signals are connected to :
			 * - SDO(MISO) to Pin21 (SPI_MISO)
			 * - LED/Backlight to Pin2 (5v)
			 * - SCK to Pin23 (SPI_CLK)
			 * - SDI(MOSI) to Pin19 (SPI_MOSI)
			 * - D/C to Pin29 (GPIOX_17)
			 * - RESET to Pin31 (GPIOX_18)
			 * - (LCD) CS to Pin24 (GPIOX_10)
			 * - GND to Pin25 (GND)
			 * - VCC/VIN to Pin17 (3.3V)
			 */
			display@0 {
				compatible = "adafruit,yx240qv29",	/* tinydrm: drm/tiny/ili9341 */
					"ilitek,ili9341";	/* fbtft/legacy: staging fbtft fallback */
				reg = <0>;
				buswidth = <8>;	/* fbtft/legacy */
				spi-max-frequency = <30000000>;
				dc-gpios = <&gpio GPIOX_17 GPIO_ACTIVE_HIGH>;
				reset-gpios = <&gpio GPIOX_18 GPIO_ACTIVE_HIGH>;
				status = "okay";
			};
		};
	};
};
