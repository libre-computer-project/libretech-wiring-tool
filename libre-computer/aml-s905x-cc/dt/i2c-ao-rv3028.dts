// SPDX-License-Identifier: (GPL-2.0-or-later OR MIT)
/*
 * Copyright (c) 2023 Mark Bumiller
 * Author: Mark Bumiller <mark.bumiller@gmail.com>
 */
/*
 * Summary: Add an RV3028 RTC module on I2C_AO bus, address 0x68.
 *
 * Requires: i2c-ao
 */
/dts-v1/;
/plugin/;

/ {
	compatible = "libre-computer,aml-s905x-cc",
		"libretech,aml-s905x-cc",
		"libre-computer,aml-s905x-cc-v2",
		"libretech,aml-s905x-cc-v2",
		"amlogic,s905x",
		"amlogic,meson-gxl";

	fragment@1 {
		target = <&i2c_AO>;
		
		__overlay__ {
			rtc@52 {
				compatible = "microcrystal,rv3028";
				reg = <0x52>;
			};
		};
	};
};
