// SPDX-License-Identifier: (GPL-2.0-or-later OR MIT)
/*
 * Copyright (c) 2022
 * Author: Da Xue <da@libre.computer>
 */
/*
 * Summary: spi-cc-1cs-st7735r-128x128-fbdev
 *
 * Pins (Header.Pin  Name  Pad  Ref — cross-ref gpio.map):
 *   7J1.22   GPIOX_0       A2      WIFI_SD_D0
 *   7J1.29   GPIOX_17      B5      BT_EN
 *   7J1.31   GPIOX_18      B7      BT_WAKE_HOST
 *
 * Requires: spi-cc-1cs
 *
 * Notes:
 * Display stack: fbtft/legacy only (CONFIG_FB_TFT / staging/fbtft).
 * Filename uses -fbdev. Not the tinydrm/DRM panel path.
 * Properties tagged "fbtft/legacy" apply to this stack.
 */
/dts-v1/;
/plugin/;

#include <dt-bindings/gpio/gpio.h>
#include <dt-bindings/gpio/meson-gxl-gpio.h>

/ {
	compatible = "libre-computer,aml-s905x-cc",
		"libretech,aml-s905x-cc",
		"libre-computer,aml-s905x-cc-v2",
		"libretech,aml-s905x-cc-v2",
		"amlogic,s905x",
		"amlogic,meson-gxl";

	fragment@0 {
		target = <&spicc>;
		
		__overlay__ {
			st7735r@0 {
				compatible = "sitronix,st7735r";
				reg = <0>;
				dc-gpios = <&gpio GPIOX_17 GPIO_ACTIVE_HIGH>;
				reset-gpios = <&gpio GPIOX_18 GPIO_ACTIVE_LOW>;

				led-gpios = <&gpio GPIOX_0 GPIO_ACTIVE_HIGH>;	/* fbtft/legacy */
				height = <128>;	/* fbtft/legacy */
				width = <128>;	/* fbtft/legacy */
				buswidth = <16>;	/* fbtft/legacy */
				
				spi-max-frequency = <41666666>;
				status = "okay";
			};
		};
	};
};
