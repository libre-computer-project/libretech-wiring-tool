// SPDX-License-Identifier: (GPL-2.0-or-later OR MIT)
/*
 * Copyright (c) 2022 Da Xue
 * Author: Da Xue <da@libre.computer>
 */
/*
 * Summary: Create pps-gpio on 7J1 pin 12 (GPIOAO_6)
 *
 * Pins (Header.Pin  Name  Pad  Ref — cross-ref gpio.map):
 *   7J1.12   GPIOAO_6      C11     PWM_F
 *
 * Notes:
 * This requires an GPIO to IRQ enabled kernel and will not work without one.
 * pps-gpio takes its IRQ from the gpio (gpiod_to_irq) and asserts on the
 * rising edge unless assert-falling-edge is set; it reads no interrupts or
 * pinctrl property.
 */
/dts-v1/;
/plugin/;

#include <dt-bindings/gpio/gpio.h>
#include <dt-bindings/gpio/meson-gxl-gpio.h>

/ {
	compatible = "libre-computer,aml-s905x-cc",
		"libretech,aml-s905x-cc",
		"libre-computer,aml-s905x-cc-v2",
		"libretech,aml-s905x-cc-v2",
		"libre-computer,aml-s905x-cc-v3",
		"libretech,aml-s905x-cc-v3",
		"amlogic,s905x",
		"amlogic,meson-gxl";

	fragment@0 {
		target-path = "/";
		__overlay__ {
			pps_gpio: pps-gpio {
				compatible = "pps-gpio";
				gpios = <&gpio_ao GPIOAO_6 GPIO_ACTIVE_HIGH>;
				status = "okay";
			};
		};
	};
};
