// SPDX-License-Identifier: (GPL-2.0-or-later OR MIT)
/*
 * Copyright (c) 2022 Da Xue <da@libre.computer>
 * Author: Da Xue <da@libre.computer>
 */
/*
 * Summary: spi-cc-1cs-cs1-ads7846-irq-35
 *
 * Pins (Header.Pin  Name  Pad  Ref — cross-ref gpio.map):
 *   7J1.35   GPIOX_7       C1      WIFI_WAKE_HOST
 *
 * Requires: spi-cc-1cs-cs1
 */
/dts-v1/;
/plugin/;

#include <dt-bindings/gpio/gpio.h>
#include <dt-bindings/gpio/meson-gxl-gpio.h>
#include <dt-bindings/interrupt-controller/irq.h>
#include <dt-bindings/interrupt-controller/amlogic,meson-gxl-gpio-intc.h>

/ {
	compatible = "libre-computer,aml-s905x-cc",
		"libretech,aml-s905x-cc",
		"libre-computer,aml-s905x-cc-v2",
		"libretech,aml-s905x-cc-v2",
		"libre-computer,aml-s905x-cc-v3",
		"libretech,aml-s905x-cc-v3",
		"amlogic,s905x",
		"amlogic,meson-gxl";
	
	fragment@0 {
		target = <&spicc>;
		
		__overlay__ {

			touchscreen@0 {
				compatible = "ti,ads7846";
				reg = <0>;
				spi-max-frequency = <2000000>;
				interrupt-parent = <&gpio_intc>;
				interrupts = <IRQID_GPIOX_7 IRQ_TYPE_EDGE_FALLING>;
				pendown-gpio = <&gpio GPIOX_7 GPIO_ACTIVE_LOW>;
				ti,x-plate-ohms = /bits/ 16 <60>;
				ti,pressure-max = /bits/ 16 <255>;
				wakeup-source;
				status = "okay";
			};
		};
	};
};
