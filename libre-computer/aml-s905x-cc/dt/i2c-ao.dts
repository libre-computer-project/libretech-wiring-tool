// SPDX-License-Identifier: (GPL-2.0-or-later OR MIT)
/*
 * Copyright (c) 2017 BayLibre, SAS.
 * Author: Neil Armstrong <narmstrong@baylibre.com>
 */
/*
 * Summary: I2C_AO on Header 7J1
 *
 * Pins (Header.Pin  Name  Pad  Ref — cross-ref gpio.map):
 *   7J1.3    GPIOAO_5      D13     I2C_SDA_AO
 *   7J1.5    GPIOAO_4      A10     I2C_SCK_AO
 * Resource-provides: bus:i2c_AO
 */
/dts-v1/;
/plugin/;

/ {
	compatible = "libre-computer,aml-s905x-cc",
		"libretech,aml-s905x-cc",
		"libre-computer,aml-s905x-cc-v2",
		"libretech,aml-s905x-cc-v2",
		"libre-computer,aml-s905x-cc-v3",
		"libretech,aml-s905x-cc-v3",
		"amlogic,s905x",
		"amlogic,meson-gxl";
fragment@0 {
		target-path = "/aliases";

		__overlay__ {
			i2c1 = "/soc/aobus@c8100000/i2c@500";
		};
	};

	fragment@1 {
		target = <&i2c_AO>;
		
		__overlay__ {
			status = "okay";
			pinctrl-0 = <&i2c_ao_pins>;
			pinctrl-names = "default";
		};
	};
};
