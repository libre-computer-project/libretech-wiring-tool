// SPDX-License-Identifier: (GPL-2.0-or-later OR MIT)
/*
 * Copyright (c) 2017 BayLibre, SAS.
 * Author: Neil Armstrong <narmstrong@baylibre.com>
 */
/*
 * Overlay aimed to enable PWM E and F on Header 7J1 Pin 32 and 35
 */

/dts-v1/;
/plugin/;

#include <dt-bindings/clock/gxbb-clkc.h>

/ {
	compatible = "libre-computer,aml-s905x-cc",
		"libretech,aml-s905x-cc",
		"libre-computer,aml-s905x-cc-v2",
		"libretech,aml-s905x-cc-v2",
		"amlogic,s905x",
		"amlogic,meson-gxl";

	fragment@0 {
		target = <&pwm_ef>;

		__overlay__ {
			status = "okay";
			pinctrl-0 = <&pwm_e_pins>, <&pwm_f_x_pins>;
			pinctrl-names = "default", "default";
			clocks = <&clkc CLKID_FCLK_DIV4>;
			clock-names = "clkin0";
		};
	};
};
