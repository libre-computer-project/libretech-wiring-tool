// SPDX-License-Identifier: (GPL-2.0-or-later OR MIT)
/*
 * Copyright (c) Libre Computer Project
 */
/*
 * Summary: spi-gpio-1cs-ili9486
 *
 * Pins (Header.Pin  Name  Pad  Ref — cross-ref gpio.map):
 *   7J1.18   GPIOX_15      C7      UART_A_RTS_N
 *   7J1.22   GPIOX_0       A2      WIFI_SD_D0
 *
 * Notes:
 * Display stack: tinydrm (DRM tiny / panel) preferred; staging fbtft is the
 * legacy fallback when both are built. Compatible order is tinydrm-first.
 * Properties tagged "fbtft/legacy" are ignored by tinydrm (CONFIG_FB_TFT_* only).
 */
/dts-v1/;
/plugin/;

#include <dt-bindings/gpio/gpio.h>
#include <dt-bindings/gpio/meson-gxl-gpio.h>

/ {
	compatible = "libre-computer,aml-s905x-cc",
		"libretech,aml-s905x-cc",
		"libre-computer,aml-s905x-cc-v2",
		"libretech,aml-s905x-cc-v2",
		"libre-computer,aml-s905x-cc-v3",
		"libretech,aml-s905x-cc-v3",
		"amlogic,s905x",
		"amlogic,meson-gxl";

	fragment@0 {
		target = <&spigpio0>;
		
		__overlay__ {

			display@0 {
				compatible = "waveshare,rpi-lcd-35",	/* tinydrm: drm/tiny/ili9486 */
					"ilitek,ili9486";	/* fbtft/legacy: staging/fbtft/fb_ili9486 */
				reg = <0>;
				spi-max-frequency = <500000>;
				rotate = <0>;	/* fbtft/legacy */
				bgr = <0>;	/* fbtft/legacy */
				fps = <30>;	/* fbtft/legacy */
				buswidth = <8>;	/* fbtft/legacy */
				regwidth = <16>;	/* fbtft/legacy */
				reset-gpios = <&gpio GPIOX_0 GPIO_ACTIVE_HIGH>;
				dc-gpios = <&gpio GPIOX_15 GPIO_ACTIVE_HIGH>;
				status = "okay";
			};
		};
	};
};
