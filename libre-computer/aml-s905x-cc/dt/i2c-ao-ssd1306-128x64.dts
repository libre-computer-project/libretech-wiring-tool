// SPDX-License-Identifier: (GPL-2.0-or-later OR MIT)
/*
 * Copyright (c) 2022 Da Xue
 * Author: Da Xue <da@libre.computer>
 */
/*
 * Summary: i2c-ao-ssd1306-128x64
 *
 * Requires: i2c-ao
 * Resource-provides: i2c:i2c_AO@0x3c
 * Resource-requires: bus:i2c_AO
 */
/dts-v1/;
/plugin/;

/ {
	compatible = "libre-computer,aml-s905x-cc",
		"libretech,aml-s905x-cc",
		"libre-computer,aml-s905x-cc-v2",
		"libretech,aml-s905x-cc-v2",
		"amlogic,s905x",
		"amlogic,meson-gxl";
fragment@1 {
		target = <&i2c_AO>;
		
		__overlay__ {
			ssd1306@3c {
				compatible = "solomon,ssd1306";
				reg = <0x3c>;
				solomon,width = <128>;
				solomon,height = <64>;
				solomon,com-invdir;
				solomon,page-offset = <8>;
			};
		};
	};
};
