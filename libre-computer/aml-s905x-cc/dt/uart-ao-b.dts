// SPDX-License-Identifier: (GPL-2.0-or-later OR MIT)
/*
 * Copyright (c) 2022 Da Xue
 * Author: Da Xue <da@libre.computer>
 */
/*
 * Summary: UART_AO_B on Header 7J1 up to 921600 baud with no flow control
 *
 * Pins (Header.Pin  Name  Pad  Ref — cross-ref gpio.map):
 *   7J1.3    GPIOAO_5      D13     I2C_SDA_AO
 *   7J1.5    GPIOAO_4      A10     I2C_SCK_AO
 */
/dts-v1/;
/plugin/;

/ {
	compatible = "libre-computer,aml-s905x-cc",
		"libretech,aml-s905x-cc",
		"libre-computer,aml-s905x-cc-v2",
		"libretech,aml-s905x-cc-v2",
		"amlogic,s905x",
		"amlogic,meson-gxl";

	/* resource-set tokens for deps/conflicts (see overlay-dependencies.md) */
	lc,provides = "bus:uart_AO_B";


	fragment@0 {
		target-path = "/aliases";

		__overlay__ {
			serial2 = "/soc/bus@c8100000/serial@4e0";
		};
	};

	fragment@1 {
		target = <&uart_AO_B>;

		__overlay__ {
			status = "okay";
			pinctrl-0 = <&uart_ao_b_pins>;
			pinctrl-names = "default";
		};
	};
};

