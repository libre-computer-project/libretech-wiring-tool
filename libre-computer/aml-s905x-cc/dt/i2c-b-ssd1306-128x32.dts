// SPDX-License-Identifier: (GPL-2.0-or-later OR MIT)
/*
 * Copyright (c) 2024 Da Xue
 * Author: Da Xue <da@libre.computer>
 */
/*
 * Summary: SSD1306 128x32 OLED on I2C_B (40P header pins 27/28)
 *
 * Requires: i2c-b
 * Resource-provides: i2c:i2c_B@0x3c
 * Resource-requires: bus:i2c_B
 */
/dts-v1/;
/plugin/;

/ {
	compatible = "libre-computer,aml-s905x-cc",
		"libretech,aml-s905x-cc",
		"libre-computer,aml-s905x-cc-v2",
		"libretech,aml-s905x-cc-v2",
		"libre-computer,aml-s905x-cc-v3",
		"libretech,aml-s905x-cc-v3",
		"amlogic,s905x",
		"amlogic,meson-gxl";

	fragment@0 {
		target = <&i2c_B>;

		__overlay__ {
			#address-cells = <1>;
			#size-cells = <0>;

			ssd1306@3c {
				compatible = "solomon,ssd1306";
				reg = <0x3c>;
				solomon,width = <128>;
				solomon,height = <32>;
				solomon,com-invdir;
				solomon,com-seq;
				solomon,page-offset = <0>;
			};
		};
	};
};
