// SPDX-License-Identifier: (GPL-2.0-or-later OR MIT)
/*
 * Copyright (c) 2022 Da Xue
 * Author: Da Xue <da@libre.computer>
 */
/*
 * Summary: PWM A on Header 7J1 Pin 33
 *
 * Pins (Header.Pin  Name  Pad  Ref — cross-ref gpio.map):
 *   7J1.33   GPIOX_6       D2      WIFI_PWREN
 */
/dts-v1/;
/plugin/;

#include <dt-bindings/clock/gxbb-clkc.h>

/ {
	compatible = "libre-computer,aml-s905x-cc",
		"libretech,aml-s905x-cc",
		"libre-computer,aml-s905x-cc-v2",
		"libretech,aml-s905x-cc-v2",
		"amlogic,s905x",
		"amlogic,meson-gxl";

	/* resource-set tokens for deps/conflicts (see overlay-dependencies.md) */
	lc,provides = "pwm_ab.ch0@7J1-33";


	fragment@0 {
		target = <&pwm_ab>;
		
		__overlay__ {
			status = "okay";
			pinctrl-0 = <&pwm_a_pins>;
			pinctrl-names = "default";
			clocks = <&clkc CLKID_FCLK_DIV4>;
			clock-names = "clkin0";
		};
	};
};
