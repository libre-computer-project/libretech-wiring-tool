// SPDX-License-Identifier: (GPL-2.0-or-later OR MIT)
/*
 * Copyright (c) 2022 Da Xue
 * Author: Da Xue <da@libre.computer>
 */
/*
 * Summary: Fan on PWM AO b on Header 7J1 Pin 12 with tach on Header 9J1 Pin 2
 *
 * Pins (Header.Pin  Name  Pad  Ref — cross-ref gpio.map):
 *   7J1.12   GPIOAO_6      C11     PWM_F
 *   9J1.2    GPIOH_4       G19     SPDIF_OUT
 */
/dts-v1/;
/plugin/;

#include <dt-bindings/clock/gxbb-clkc.h>
#include <dt-bindings/gpio/meson-gxl-gpio.h>
#include <dt-bindings/interrupt-controller/irq.h>
#include <dt-bindings/interrupt-controller/amlogic,meson-gxl-gpio-intc.h>

/ {
	compatible = "libre-computer,aml-s905x-cc",
		"libretech,aml-s905x-cc",
		"libre-computer,aml-s905x-cc-v2",
		"libretech,aml-s905x-cc-v2",
		"amlogic,s905x",
		"amlogic,meson-gxl";
	
	fragment@0 {
		target = <&spdif_out_h_pins>;
		__overlay__ {
			mux {
				bias-pull-up;
			};
		};
	};
	
	fragment@1 {
		target-path = "/";
		__overlay__ {
			fan0: pwm-fan {
				compatible = "pwm-fan";
				pwms = <&pwm_AO_ab 1 25000 0>;
				interrupt-parent = <&gpio_intc>;
				interrupts = <IRQID_GPIOH_4 IRQ_TYPE_EDGE_FALLING>;
				pulses-per-revolution = <2>;
			};
		};
	};
};
