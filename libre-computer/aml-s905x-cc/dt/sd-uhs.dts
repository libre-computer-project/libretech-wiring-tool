// SPDX-License-Identifier: (GPL-2.0+ OR MIT)
/*
 * Copyright (c) 2022 Da Xue <da@libre.computer>
 * Author: Da Xue <da@libre.computer>
 */

/dts-v1/;
/plugin/;

/ {
	compatible = "libretech,cc", "amlogic,s905x", "amlogic,meson-gxl";

	fragment@0 {
		target = <&sd_emmc_b>;
		
		__overlay__ {
			sd-uhs-ddr50;
			sd-uhs-sdr50;
			max-frequency = <100000000>;
		};
	};
};
