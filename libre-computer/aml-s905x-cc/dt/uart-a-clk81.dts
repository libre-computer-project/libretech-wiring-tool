// SPDX-License-Identifier: (GPL-2.0-or-later OR MIT)
/*
 * Copyright (c) 2017 BayLibre, SAS.
 * Author: Neil Armstrong <narmstrong@baylibre.com>
 */
/*
 * Summary: UART_A on Header 7J1
 *
 * Pins (Header.Pin  Name  Pad  Ref — cross-ref gpio.map):
 *   7J1.8    GPIOX_12      A6      UART_A_TX
 *   7J1.10   GPIOX_13      B6      UART_A_RX
 *   7J1.16   GPIOX_14      C6      UART_A_CTS_N
 *   7J1.18   GPIOX_15      C7      UART_A_RTS_N
 */
/dts-v1/;
/plugin/;

#include <dt-bindings/clock/gxbb-clkc.h>

/ {
	compatible = "libre-computer,aml-s905x-cc",
		"libretech,aml-s905x-cc",
		"libre-computer,aml-s905x-cc-v2",
		"libretech,aml-s905x-cc-v2",
		"amlogic,s905x",
		"amlogic,meson-gxl";

	fragment@0 {
		target-path = "/aliases";

		__overlay__ {
			serial1 = "/soc/cbus@c1100000/serial@84c0";
		};
	};

	fragment@1 {
		target = <&uart_A>;

		__overlay__ {
			status = "okay";
			pinctrl-0 = <&uart_a_pins>;
			pinctrl-names = "default";
			clocks = <&xtal>, <&clkc CLKID_UART0>, <&clkc CLKID_CLK81>;
			clock-names = "xtal", "pclk", "baud";
		};
	};
};
