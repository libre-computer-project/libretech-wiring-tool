// SPDX-License-Identifier: (GPL-2.0-or-later OR MIT)
/*
 * Copyright (c) 2017 BayLibre, SAS.
 * Author: Thomas Rohloff <v10lator@myway.de>
 */
/*
 * Overlay aimed to add an AT24C32 EEPROM module on I2C_B bus, address 0x57.
 */

/dts-v1/;
/plugin/;

/ {
	compatible = "libre-computer,aml-s905x-cc",
		"libretech,aml-s905x-cc",
		"libre-computer,aml-s905x-cc-v2",
		"libretech,aml-s905x-cc-v2",
		"amlogic,s905x",
		"amlogic,meson-gxl";

	fragment@1 {
		target = <&i2c_B>;
		
		__overlay__ {
			eeprom@57 {
				compatible = "at,24c32";
				reg = <0x57>;
			};
		};
	};
};
