// SPDX-License-Identifier: (GPL-2.0-or-later OR MIT)
/*
 * Copyright (c) 2022 Da Xue
 * Author: Da Xue <da@libre.computer>
 */
/*
 * Summary: Create a gpio button on 7J1 pin 31 (GPIOX_18) linked to the power key
 *
 * Pins (Header.Pin  Name  Pad  Ref — cross-ref gpio.map):
 *   7J1.31   GPIOX_18      B7      BT_WAKE_HOST
 */
/dts-v1/;
/plugin/;

#include <dt-bindings/gpio/gpio.h>
#include <dt-bindings/gpio/meson-gxl-gpio.h>
#include <dt-bindings/interrupt-controller/irq.h>
#include <dt-bindings/interrupt-controller/amlogic,meson-gxl-gpio-intc.h>

/ {
	compatible = "libre-computer,aml-s905x-cc",
		"libretech,aml-s905x-cc",
		"libre-computer,aml-s905x-cc-v2",
		"libretech,aml-s905x-cc-v2",
		"amlogic,s905x",
		"amlogic,meson-gxl";

	fragment@0 {
		target-path = "/";
		__overlay__ {
			gpio_keys: gpio-keys {
				compatible = "gpio-keys";
				#address-cells = <1>;
				#size-cells = <0>;
				autorepeat;
				
				power-button {
					label = "Power Button";
					linux,code = <116>;
					interrupts-extended = <&gpio_intc IRQID_GPIOX_18 IRQ_TYPE_LEVEL_LOW>;
					linux,can-disable;
					wakeup-source;
				};
			};
		};
	};
};

