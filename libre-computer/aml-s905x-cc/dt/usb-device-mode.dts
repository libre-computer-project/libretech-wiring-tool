// SPDX-License-Identifier: (GPL-2.0-or-later OR MIT)
/*
 * Copyright (c) 2023 Da Xue
 * Author: Da Xue <da@libre.computer>
 */
/*
 * Summary: usb-device-mode
 */
/dts-v1/;
/plugin/;

/ {
	compatible = "libre-computer,aml-s905x-cc",
		"libretech,aml-s905x-cc",
		"libre-computer,aml-s905x-cc-v2",
		"libretech,aml-s905x-cc-v2",
		"amlogic,s905x",
		"amlogic,meson-gxl";

	/* resource-set tokens for deps/conflicts (see overlay-dependencies.md) */
	lc,provides = "excl:usb.dr_mode";
	fragment@0 {
		target = <&usb>;
		
		__overlay__ {
			dr_mode = "peripheral";
		};
	};
};

