// SPDX-License-Identifier: (GPL-2.0-or-later OR MIT)
/*
 * Copyright (c) 2017 BayLibre, SAS.
 * Author: Thomas Rohloff <v10lator@myway.de>
 */
/*
 * Summary: Add an AT24C32 EEPROM module on I2C_AO bus, address 0x57.
 *
 * Requires: i2c-ao
 */
/dts-v1/;
/plugin/;

/ {
	compatible = "libre-computer,aml-s905x-cc",
		"libretech,aml-s905x-cc",
		"libre-computer,aml-s905x-cc-v2",
		"libretech,aml-s905x-cc-v2",
		"amlogic,s905x",
		"amlogic,meson-gxl";

	/* resource-set tokens for deps/conflicts (see overlay-dependencies.md) */
	lc,provides = "i2c:i2c_AO@0x50";
	lc,requires = "bus:i2c_AO";


	fragment@1 {
		target = <&i2c_AO>;
		
		__overlay__ {
			eeprom@57 {
				compatible = "atmel,24c32";
				reg = <0x57>;
			};
		};
	};
};
