// SPDX-License-Identifier: (GPL-2.0-or-later OR MIT)
/*
 * Copyright (c) 2022 Da Xue
 * Author: Da Xue <da@libre.computer>
 */
/*
 * Summary: PWM AO B 9 on Header 7J1 Pin 13
 *
 * Pins (Header.Pin  Name  Pad  Ref — cross-ref gpio.map):
 *   7J1.13   GPIOAO_9      C12     I2SOUT-CH45
 * Resource-provides: pwm_AO_ab.ch1@7J1-13
 */
/dts-v1/;
/plugin/;

#include <dt-bindings/clock/gxbb-clkc.h>

/ {
	compatible = "libre-computer,aml-s905x-cc",
		"libretech,aml-s905x-cc",
		"libre-computer,aml-s905x-cc-v2",
		"libretech,aml-s905x-cc-v2",
		"amlogic,s905x",
		"amlogic,meson-gxl";
fragment@0 {
		target = <&pwm_AO_ab>;
		
		__overlay__ {
			status = "okay";
			pinctrl-0 = <&pwm_ao_b_pins>;
			pinctrl-names = "default";
			clocks = <&xtal>, <&clkc CLKID_CLK81>;
			clock-names = "xtal", "clk81";
		};
	};
};
