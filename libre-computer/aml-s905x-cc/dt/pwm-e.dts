// SPDX-License-Identifier: (GPL-2.0-or-later OR MIT)
/*
 * Copyright (c) 2017 BayLibre, SAS.
 * Author: Neil Armstrong <narmstrong@baylibre.com>
 */
/*
 * Summary: PWM E on Header 7J1 Pin 32
 *
 * Pins (Header.Pin  Name  Pad  Ref — cross-ref gpio.map):
 *   7J1.32   GPIOX_16      A3      WIFI_32K
 * Resource-provides: pwm_ef.ch0@7J1-32
 */
/dts-v1/;
/plugin/;

#include <dt-bindings/clock/gxbb-clkc.h>

/ {
	compatible = "libre-computer,aml-s905x-cc",
		"libretech,aml-s905x-cc",
		"libre-computer,aml-s905x-cc-v2",
		"libretech,aml-s905x-cc-v2",
		"libre-computer,aml-s905x-cc-v3",
		"libretech,aml-s905x-cc-v3",
		"amlogic,s905x",
		"amlogic,meson-gxl";
fragment@0 {
		target = <&pwm_ef>;

		__overlay__ {
			status = "okay";
			pinctrl-0 = <&pwm_e_pins>;
			pinctrl-names = "default";
			clocks = <&clkc CLKID_FCLK_DIV4>;
			clock-names = "clkin0";
		};
	};
};
