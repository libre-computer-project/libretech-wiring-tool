// SPDX-License-Identifier: (GPL-2.0-or-later OR MIT)
/*
 * Copyright (c) 2022 Thomas McKahan <tonymckahan@gmail.com>
 * Author: Thomas McKahan <tonymckahan@gmail.com>
 */
/*
 * Summary: Overlay to enable the Ilitek ILI9341 Hat-shaped panels
 *
 * Pins (Header.Pin  Name  Pad  Ref — cross-ref gpio.map):
 *   7J1.19   GPIOX_8       B4      BTPCM_DOUT
 *   7J1.21   GPIOX_9       B3      BTPCM_DIN
 *   7J1.22   GPIOX_0       A2      WIFI_SD_D0
 *   7J1.23   GPIOX_11      C4      BTPCM_CLK
 *   7J1.24   GPIOX_10      C5      BTPCM_SYNC
 *   7J1.31   GPIOX_18      B7      BT_WAKE_HOST
 *
 * Requires: spi-cc-1cs
 *
 * Notes:
 * Display stack: tinydrm (DRM tiny / panel) preferred; staging fbtft is the
 * legacy fallback when both are built. Compatible order is tinydrm-first.
 * Properties tagged "fbtft/legacy" are ignored by tinydrm (CONFIG_FB_TFT_* only).
 * - Adafruit 2.4" TFT LCD with Touchscreen Hat
 * - Adafruit 2.8" TFT LCD with Touchscreen Hat
 */
/dts-v1/;
/plugin/;

#include <dt-bindings/gpio/gpio.h>
#include <dt-bindings/gpio/meson-gxl-gpio.h>

/ {
	compatible = "libre-computer,aml-s905x-cc",
		"libretech,aml-s905x-cc",
		"libre-computer,aml-s905x-cc-v2",
		"libretech,aml-s905x-cc-v2",
		"libre-computer,aml-s905x-cc-v3",
		"libretech,aml-s905x-cc-v3",
		"amlogic,s905x",
		"amlogic,meson-gxl";

	fragment@0 {
		target = <&spicc>;
		
		__overlay__ {
			display@0 {
				compatible = "adafruit,yx240qv29",	/* tinydrm: drm/tiny/ili9341 */
					"ilitek,ili9341";	/* fbtft/legacy: staging fbtft fallback */
				reg = <0>;
				buswidth = <8>;	/* fbtft/legacy */
				spi-max-frequency = <30000000>;
				dc-gpios = <&gpio GPIOX_0 GPIO_ACTIVE_HIGH>;
				reset-gpios = <&gpio GPIOX_18 GPIO_ACTIVE_HIGH>;
				rotation = <90>;
				status = "okay";
			};
		};
	};
};
