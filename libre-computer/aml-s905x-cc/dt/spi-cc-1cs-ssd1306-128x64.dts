// SPDX-License-Identifier: (GPL-2.0-or-later OR MIT)
/*
 * Copyright (c) 2022 Da Xue
 * Author: Da Xue <da@libre.computer>
 */
/*
 * Summary: spi-cc-1cs-ssd1306-128x64
 *
 * Pins (Header.Pin  Name  Pad  Ref — cross-ref gpio.map):
 *   7J1.29   GPIOX_17      B5      BT_EN
 *   7J1.31   GPIOX_18      B7      BT_WAKE_HOST
 *
 * Requires: spi-cc-1cs
 */
/dts-v1/;
/plugin/;

#include <dt-bindings/gpio/gpio.h>
#include <dt-bindings/gpio/meson-gxl-gpio.h>

/ {
	compatible = "libre-computer,aml-s905x-cc",
		"libretech,aml-s905x-cc",
		"libre-computer,aml-s905x-cc-v2",
		"libretech,aml-s905x-cc-v2",
		"libre-computer,aml-s905x-cc-v3",
		"libretech,aml-s905x-cc-v3",
		"amlogic,s905x",
		"amlogic,meson-gxl";

	fragment@0 {
		target = <&spicc>;
		
		__overlay__ {
			ssd1306@0 {
				compatible = "solomon,ssd1306";
				reg = <0>;
				dc-gpios = <&gpio GPIOX_17 GPIO_ACTIVE_HIGH>;
				reset-gpios = <&gpio GPIOX_18 GPIO_ACTIVE_LOW>;
				solomon,width = <128>;
				solomon,height = <64>;
				solomon,com-invdir;
				solomon,page-offset = <8>;
				spi-max-frequency = <41666666>;
				status = "okay";
			};
		};
	};
};
