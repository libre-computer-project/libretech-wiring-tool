// SPDX-License-Identifier: (GPL-2.0-or-later OR MIT)
/*
 * Copyright (c) 2022 Thomas McKahan <tonymckahan@gmail.com>
 * Author: Thomas McKahan <tonymckahan@gmail.com>
 */
/*
 * Overlay to enable 1-wire on gpio "4" (BCM)
 */

/dts-v1/;
/plugin/;

#include <dt-bindings/gpio/gpio.h>
#include <dt-bindings/gpio/meson-gxl-gpio.h>

/ {
	compatible = "libre-computer,aml-s905x-cc",
		"libretech,aml-s905x-cc",
		"libre-computer,aml-s905x-cc-v2",
		"libretech,aml-s905x-cc-v2",
		"amlogic,s905x",
		"amlogic,meson-gxl";

	fragment@0 {
		target-path = "/";
		__overlay__ {
			onewire@0 {
				compatible = "w1-gpio";
				gpios = <&gpio GPIOCLK_0 GPIO_ACTIVE_HIGH>;
				status = "okay";
			};
		};
	};
};
