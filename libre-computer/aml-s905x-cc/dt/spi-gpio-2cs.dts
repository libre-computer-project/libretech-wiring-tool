// SPDX-License-Identifier: (GPL-2.0-or-later OR MIT)
/*
 * Copyright (c) 2022 Da Xue
 * Author: Da Xue <da@libre.computer>
 */
/*
 * Summary: spi-gpio-2cs
 *
 * Pins (Header.Pin  Name  Pad  Ref — cross-ref gpio.map):
 *   7J1.19   GPIOX_8       B4      BTPCM_DOUT
 *   7J1.21   GPIOX_9       B3      BTPCM_DIN
 *   7J1.23   GPIOX_11      C4      BTPCM_CLK
 *   7J1.24   GPIOX_10      C5      BTPCM_SYNC
 *   7J1.26   GPIOX_1       C3      WIFI_SD_D1
 */
/dts-v1/;
/plugin/;

#include <dt-bindings/gpio/gpio.h>
#include <dt-bindings/gpio/meson-gxl-gpio.h>

/ {
	compatible = "libre-computer,aml-s905x-cc",
		"libretech,aml-s905x-cc",
		"libre-computer,aml-s905x-cc-v2",
		"libretech,aml-s905x-cc-v2",
		"libre-computer,aml-s905x-cc-v3",
		"libretech,aml-s905x-cc-v3",
		"amlogic,s905x",
		"amlogic,meson-gxl";

	fragment@0 {
		target-path = "/";
		
		__overlay__ {
			spigpio0: spigpio@0 {
				compatible = "spi-gpio";
				#address-cells = <1>;
				#size-cells = <0>;
				ranges;

				pinctrl-0 = <&spi_pins>;
				pinctrl-1 = <&spi_pins>, <&spi_idle_high_pins>;
				pinctrl-2 = <&spi_pins>, <&spi_idle_low_pins>;
				pinctrl-names = "default", "idle-high", "idle-low";

				gpio-sck = <&gpio GPIOX_11 GPIO_ACTIVE_HIGH>;
				gpio-miso = <&gpio GPIOX_9 GPIO_ACTIVE_HIGH>;
				gpio-mosi = <&gpio GPIOX_8 GPIO_ACTIVE_HIGH>;
				cs-gpios = <&gpio GPIOX_10 GPIO_ACTIVE_LOW>, <&gpio GPIOX_1 GPIO_ACTIVE_LOW>;
				num-chipselects = <2>;
				status = "okay";
			};

		};
	};
};

