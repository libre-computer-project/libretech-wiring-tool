// SPDX-License-Identifier: (GPL-2.0-or-later OR MIT)
/*
 * Copyright (c) 2017 BayLibre, SAS.
 * Copyright (c) 2023 Joshua Dye.
 * Original Author: Neil Armstrong <narmstrong@baylibre.com>
 * Modified for PCF8523 by: Joshua Dye
 */
/*
 * Summary: Add an PCF823 RTC module on I2C_AO bus, address 0x68.
 *
 * Requires: i2c-ao
 * Resource-provides: i2c:i2c_AO@0x68
 * Resource-requires: bus:i2c_AO
 *
 * Notes:
 * Modified from DS3231 overlay.
 */
/dts-v1/;
/plugin/;

/ {
	compatible = "libre-computer,aml-s905x-cc",
		"libretech,aml-s905x-cc",
		"libre-computer,aml-s905x-cc-v2",
		"libretech,aml-s905x-cc-v2",
		"amlogic,s905x",
		"amlogic,meson-gxl";
fragment@1 {
		target = <&i2c_AO>;
		
		__overlay__ {
			rtc@68 {
				compatible = "nxp,pcf8523";
				reg = <0x68>;
			};
		};
	};
};
