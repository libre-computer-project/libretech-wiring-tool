// SPDX-License-Identifier: (GPL-2.0-or-later OR MIT)
/*
 * Copyright (c) 2017 BayLibre, SAS.
 * Author: Neil Armstrong <narmstrong@baylibre.com>
 */
/*
 * Overlay aimed to enable UART_A on Header 7J1 :
 * Pins 8 (TX), 10 (RX), 16 (CTS), 18 (RTS)
 */

/dts-v1/;
/plugin/;

#include <dt-bindings/clock/gxbb-clkc.h>

/ {
	compatible = "libre-computer,aml-s905x-cc",
		"libretech,aml-s905x-cc",
		"libre-computer,aml-s905x-cc-v2",
		"libretech,aml-s905x-cc-v2",
		"amlogic,s905x",
		"amlogic,meson-gxl";

	fragment@0 {
		target-path = "/aliases";

		__overlay__ {
			serial1 = "/soc/cbus@c1100000/serial@84c0";
		};
	};

	fragment@1 {
		target = <&uart_A>;

		__overlay__ {
			status = "okay";
			pinctrl-0 = <&uart_a_pins>, <&uart_a_cts_rts_pins>;
			pinctrl-names = "default";
			uart-has-rtscts;
			clocks = <&xtal>, <&clkc CLKID_UART0>, <&clkc CLKID_CLK81>;
			clock-names = "xtal", "pclk", "baud";
		};
	};
};
