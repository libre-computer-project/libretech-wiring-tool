// SPDX-License-Identifier: (GPL-2.0-or-later OR MIT)
/*
 * Copyright (c) 2022 Da Xue
 * Author: Da Xue <da@libre.computer>
 */
/*
 * Summary: SD UHS increase max clock
 */
/dts-v1/;
/plugin/;

/ {
	compatible = "libre-computer,aml-s905x-cc",
		"libretech,aml-s905x-cc",
		"libre-computer,aml-s905x-cc-v2",
		"libretech,aml-s905x-cc-v2",
		"libre-computer,aml-s905x-cc-v3",
		"libretech,aml-s905x-cc-v3",
		"amlogic,s905x",
		"amlogic,meson-gxl";

	fragment@0 {
		target = <&sd_emmc_b>;
		
		__overlay__ {
			max-frequency = <200000000>;
		};
	};
};
