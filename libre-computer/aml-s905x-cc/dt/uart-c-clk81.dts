// SPDX-License-Identifier: (GPL-2.0-or-later OR MIT)
/*
 * Copyright (c) 2024 Da Xue
 * Author: Da Xue <da@libre.computer>
 */
/*
 * Summary: UART_C on 40P header 7J1 pins 19 (TX) and 21 (RX) with CLK81 for additional baud rates
 *
 * Pins (Header.Pin  Name  Pad  Ref — cross-ref gpio.map):
 *   7J1.19   GPIOX_8       B4      BTPCM_DOUT
 *   7J1.21   GPIOX_9       B3      BTPCM_DIN
 *
 * Resource-provides: bus:uart_C
 */
/dts-v1/;
/plugin/;

#include <dt-bindings/clock/gxbb-clkc.h>

/ {
	compatible = "libre-computer,aml-s905x-cc",
		"libretech,aml-s905x-cc",
		"libre-computer,aml-s905x-cc-v2",
		"libretech,aml-s905x-cc-v2",
		"libre-computer,aml-s905x-cc-v3",
		"libretech,aml-s905x-cc-v3",
		"amlogic,s905x",
		"amlogic,meson-gxl";

	fragment@0 {
		target-path = "/aliases";

		__overlay__ {
			serial3 = "/soc/bus@c1100000/serial@8700";
		};
	};

	fragment@1 {
		target = <&uart_C>;

		__overlay__ {
			status = "okay";
			pinctrl-0 = <&uart_c_pins>;
			pinctrl-names = "default";
			clocks = <&xtal>, <&clkc CLKID_UART2>, <&clkc CLKID_CLK81>;
			clock-names = "xtal", "pclk", "baud";
		};
	};
};
