// SPDX-License-Identifier: (GPL-2.0-or-later OR MIT)
/*
 * Copyright (c) 2022 Da Xue
 * Author: Da Xue <da@libre.computer>
 */
/*
 * Summary: PWM AO A and B on Header 7J1 Pin 11 and Pin 13
 *
 * Pins (Header.Pin  Name  Pad  Ref — cross-ref gpio.map):
 *   7J1.11   GPIOAO_8*     F17     I2SOUT-CH23
 *   7J1.13   GPIOAO_9      C12     I2SOUT-CH45
 */
/dts-v1/;
/plugin/;

#include <dt-bindings/clock/gxbb-clkc.h>

/ {
	compatible = "libre-computer,aml-s905x-cc",
		"libretech,aml-s905x-cc",
		"libre-computer,aml-s905x-cc-v2",
		"libretech,aml-s905x-cc-v2",
		"amlogic,s905x",
		"amlogic,meson-gxl";

	/* resource-set tokens for deps/conflicts (see overlay-dependencies.md) */
	lc,provides = "pwm_AO_ab.ch0@7J1-11", "pwm_AO_ab.ch1@7J1-13";
	lc,revokes = "cec_AO";

	fragment@0 {
		target = <&cec_AO>;
		
		__overlay__ {
			status = "disabled";
		};
	};

	fragment@1 {
		target = <&pwm_AO_ab>;
		
		__overlay__ {
			status = "okay";
			pinctrl-0 = <&pwm_ao_a_8_pins>, <&pwm_ao_b_pins>;
			pinctrl-names = "default", "default";
			clocks = <&xtal>, <&clkc CLKID_CLK81>;
			clock-names = "xtal", "clk81";
		};
	};
};
