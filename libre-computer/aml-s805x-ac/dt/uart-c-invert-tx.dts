// SPDX-License-Identifier: (GPL-2.0-or-later OR MIT)
/*
 * Copyright (c) 2024 Da Xue
 * Author: Da Xue <da@libre.computer>
 */
/*
 * Summary: Invert UART_C TX on 40P header 7J1 pin 19
 *
 * Pins (Header.Pin  Name  Pad  Ref — cross-ref gpio.map):
 *   7J1.19   GPIOX_8       A5      UART_C_TX
 *
 * Requires: uart-c
 *
 * Resource-requires: bus:uart_C
 *
 * Notes:
 * This overlay must be merged and will only take effect after reboot.
 * uart_C is disabled in the base DTB; alone this sets a property on a
 * disabled port.
 */
/dts-v1/;
/plugin/;

/ {
	compatible = "libre-computer,aml-s805x-ac",
		"libretech,aml-s805x-ac",
		"libre-computer,aml-s805x-ac-v2",
		"libretech,aml-s805x-ac-v2",
		"amlogic,s805x",
		"amlogic,meson-gxl";

	fragment@0 {
		target = <&uart_C>;

		__overlay__ {
			uart-invert-tx;
		};
	};
};
