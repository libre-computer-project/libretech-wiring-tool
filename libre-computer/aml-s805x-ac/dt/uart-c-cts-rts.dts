// SPDX-License-Identifier: (GPL-2.0-or-later OR MIT)
/*
 * Copyright (c) 2024 Da Xue
 * Author: Da Xue <da@libre.computer>
 */
/*
 * Summary: UART_C on 40P header 7J1 pins 19 (TX), 21 (RX), 23 (RTS), 24 (CTS)
 *
 * Pins (Header.Pin  Name  Pad  Ref — cross-ref gpio.map):
 *   7J1.19   GPIOX_8       A5      UART_C_TX
 *   7J1.21   GPIOX_9       B5      UART_C_RX
 *   7J1.23   GPIOX_11      B6      UART_C_RTS_N
 *   7J1.24   GPIOX_10      A4      UART_C_CTS_N
 */
/dts-v1/;
/plugin/;

/ {
	compatible = "libre-computer,aml-s805x-ac",
		"libretech,aml-s805x-ac",
		"libre-computer,aml-s805x-ac-v2",
		"libretech,aml-s805x-ac-v2",
		"amlogic,s805x",
		"amlogic,meson-gxl";

	fragment@0 {
		target-path = "/aliases";

		__overlay__ {
			serial3 = "/soc/cbus@c1100000/serial@8700";
		};
	};

	fragment@1 {
		target = <&uart_C>;

		__overlay__ {
			status = "okay";
			pinctrl-0 = <&uart_c_pins>,<&uart_c_cts_rts_pins>;
			pinctrl-names = "default";
		};
	};
};
