// SPDX-License-Identifier: (GPL-2.0-or-later OR MIT)
/*
 * Copyright (c) 2020 BayLibre, SAS.
 * Author: Nicolas Belin <nbelin@baylibre.com>
 */
/*
 * Summary: SDIO on emmc_a. This includes enabling pwm-e and
 *
 * Pins (Header.Pin  Name  Pad  Ref — cross-ref gpio.map):
 *   7J1.8    GPIOX_12      B4      BT_EN
 *   7J1.10   GPIOX_13      A6      BT_WAKE_HOST
 *
 * Notes:
 * uartc.
 */
/dts-v1/;
/plugin/;

#include <dt-bindings/gpio/gpio.h>
#include <dt-bindings/gpio/meson-gxl-gpio.h>
#include <dt-bindings/clock/gxbb-clkc.h>

/ {
	compatible = "libre-computer,aml-s805x-ac",
		"libretech,aml-s805x-ac",
		"libre-computer,aml-s805x-ac-v2",
		"libretech,aml-s805x-ac-v2",
		"amlogic,s805x",
		"amlogic,meson-gxl";

	fragment@0 {
		target = <&uart_C>;

		__overlay__ {
			bluetooth {
				compatible = "realtek,rtl8822cs-bt";
				enable-gpios = <&gpio GPIOX_12 GPIO_ACTIVE_HIGH>;
				host-wake-gpios = <&gpio GPIOX_13 GPIO_ACTIVE_HIGH>;
			};
		};
	};
};

