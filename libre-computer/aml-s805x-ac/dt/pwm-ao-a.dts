// SPDX-License-Identifier: (GPL-2.0-or-later OR MIT)
/*
 * Copyright (c) 2024 Da Xue
 * Author: Da Xue <da@libre.computer>
 */
/*
 * Summary: PWM AO A on Header 7J1 Pin 11
 *
 * Pins (Header.Pin  Name  Pad  Ref — cross-ref gpio.map):
 *   7J1.11   GPIOAO_8*     E15     PWM
 */
/dts-v1/;
/plugin/;

#include <dt-bindings/clock/gxbb-clkc.h>

/ {
	compatible = "libre-computer,aml-s805x-ac",
		"libretech,aml-s805x-ac",
		"libre-computer,aml-s805x-ac-v2",
		"libretech,aml-s805x-ac-v2",
		"amlogic,s805x",
		"amlogic,meson-gxl";

	fragment@0 {
		target = <&cec_AO>;

		__overlay__ {
			status = "disabled";
		};
	};

	fragment@1 {
		target = <&pwm_AO_ab>;

		__overlay__ {
			status = "okay";
			pinctrl-0 = <&pwm_ao_a_8_pins>;
			pinctrl-names = "default";
			clocks = <&xtal>, <&clkc CLKID_CLK81>;
			clock-names = "xtal", "clk81";
		};
	};
};
