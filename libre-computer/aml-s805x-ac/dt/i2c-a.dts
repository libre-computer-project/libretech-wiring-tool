// SPDX-License-Identifier: (GPL-2.0+ OR MIT)
/*
 * Copyright (c) 2024 Da Xue
 * Author: Da Xue <da@libre.computer>
 */

/*
 * Enables I2C_A on 40P header 7J1 pins 27 (SDA) and 28 (SCL) as i2c-1
 * Please update the AML-S805X-AC firmware to the latest version.
 */

/dts-v1/;
/plugin/;

/ {
	compatible = "libretech,aml-s805x-ac", "amlogic,s805x", "amlogic,meson-gxl";

	fragment@0 {
		target-path = "/aliases";

		__overlay__ {
			i2c1 = "/soc/bus@c1100000/i2c@8500";
		};
	};


	fragment@1 {
		target = <&i2c_A>;

		__overlay__ {
			status = "okay";
			pinctrl-0 = <&i2c_a_pins>;
			pinctrl-names = "default";
		};
	};
};
