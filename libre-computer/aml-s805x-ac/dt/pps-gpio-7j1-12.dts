// SPDX-License-Identifier: (GPL-2.0-or-later OR MIT)
/*
 * Copyright (c) 2024 Peter Rippe
 * Author: Peter Rippe
 */
/*
 * Summary: Create pps-gpio on 7J1 pin 12 (GPIOH_7)
 *
 * Pins (Header.Pin  Name  Pad  Ref — cross-ref gpio.map):
 *   7J1.12   GPIOH_7       K15     TMS
 *
 * Notes:
 * This requires an GPIO to IRQ enabled kernel and will not work without one.
 * pps-gpio takes its IRQ from the gpio (gpiod_to_irq) and asserts on the
 * rising edge unless assert-falling-edge is set; it reads no interrupts or
 * pinctrl property. (An earlier note here preferred a level interrupt; the
 * driver never read that setting.)
 */
/dts-v1/;
/plugin/;

#include <dt-bindings/gpio/gpio.h>
#include <dt-bindings/gpio/meson-gxl-gpio.h>

/ {
	compatible = "libre-computer,aml-s805x-ac",
		"libretech,aml-s805x-ac",
		"libre-computer,aml-s805x-ac-v2",
		"libretech,aml-s805x-ac-v2",
		"amlogic,s805x",
		"amlogic,meson-gxl";

	fragment@0 {
		target-path = "/";
		__overlay__ {
			pps_gpio: pps-gpio {
				compatible = "pps-gpio";
				gpios = <&gpio GPIOH_7 GPIO_ACTIVE_HIGH>;
				status = "okay";
			};
		};
	};
};
