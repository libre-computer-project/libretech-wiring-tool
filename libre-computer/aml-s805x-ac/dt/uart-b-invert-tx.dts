// SPDX-License-Identifier: (GPL-2.0-or-later OR MIT)
/*
 * Copyright (c) 2024 Da Xue
 * Author: Da Xue <da@libre.computer>
 */
/*
 * Summary: Invert UART_B TX on 40P header 7J1 pin 27
 *
 * Pins (Header.Pin  Name  Pad  Ref — cross-ref gpio.map):
 *   7J1.27   GPIODV_24     F3      I2C_SDA_A
 *
 * Notes:
 * This overlay must be merged and will only take effect after reboot.
 */
/dts-v1/;
/plugin/;

/ {
	compatible = "libre-computer,aml-s805x-ac",
		"libretech,aml-s805x-ac",
		"libre-computer,aml-s805x-ac-v2",
		"libretech,aml-s805x-ac-v2",
		"amlogic,s805x",
		"amlogic,meson-gxl";

	fragment@0 {
		target = <&uart_B>;

		__overlay__ {
			uart-invert-tx;
		};
	};
};
