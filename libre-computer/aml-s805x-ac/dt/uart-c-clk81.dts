// SPDX-License-Identifier: (GPL-2.0-or-later OR MIT)
/*
 * Copyright (c) 2024 Da Xue
 * Author: Da Xue <da@libre.computer>
 */
/*
 * Enables UART_C on 40P header 7J1 pins 19 (TX) and 21 (RX) with CLK81 for additional baud rates
 */

/dts-v1/;
/plugin/;

#include <dt-bindings/clock/gxbb-clkc.h>

/ {
	compatible = "libre-computer,aml-s805x-ac",
		"libretech,aml-s805x-ac",
		"libre-computer,aml-s805x-ac-v2",
		"libretech,aml-s805x-ac-v2",
		"amlogic,s805x",
		"amlogic,meson-gxl";

	fragment@0 {
		target-path = "/aliases";

		__overlay__ {
			serial3 = "/soc/cbus@c1100000/serial@8700";
		};
	};

	fragment@1 {
		target = <&uart_C>;

		__overlay__ {
			status = "okay";
			pinctrl-0 = <&uart_c_pins>;
			pinctrl-names = "default";
			clocks = <&xtal>, <&clkc CLKID_UART2>, <&clkc CLKID_CLK81>;
			clock-names = "xtal", "pclk", "baud";
		};
	};
};
