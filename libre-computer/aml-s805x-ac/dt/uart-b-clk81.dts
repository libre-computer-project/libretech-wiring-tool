// SPDX-License-Identifier: (GPL-2.0-or-later OR MIT)
/*
 * Copyright (c) 2024 Da Xue
 * Author: Da Xue <da@libre.computer>
 */
/*
 * Enables UART_B on 40P header 7J1 pins 27 (TX) and 28 (RX) with CLK81 for additional baud rates
 */

/dts-v1/;
/plugin/;

#include <dt-bindings/clock/gxbb-clkc.h>

/ {
	compatible = "libre-computer,aml-s805x-ac",
		"libretech,aml-s805x-ac",
		"libre-computer,aml-s805x-ac-v2",
		"libretech,aml-s805x-ac-v2",
		"amlogic,s805x",
		"amlogic,meson-gxl";

	fragment@0 {
		target-path = "/aliases";

		__overlay__ {
			serial2 = "/soc/cbus@c1100000/serial@84dc";
		};
	};

	fragment@1 {
		target = <&uart_B>;

		__overlay__ {
			status = "okay";
			pinctrl-0 = <&uart_b_pins>;
			pinctrl-names = "default";
			clocks = <&xtal>, <&clkc CLKID_UART1>, <&clkc CLKID_CLK81>;
			clock-names = "xtal", "pclk", "baud";
		};
	};
};
