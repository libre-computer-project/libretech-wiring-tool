// SPDX-License-Identifier: (GPL-2.0-or-later OR MIT)
/*
 * Copyright (c) 2024 Da Xue
 * Author: Da Xue <da@libre.computer>
 */
/*
 * Summary: UART_A on 40P header 7J1 pins 8 (TX) and 10 (RX)
 *
 * Pins (Header.Pin  Name  Pad  Ref — cross-ref gpio.map):
 *   7J1.8    GPIOX_12      B4      BT_EN
 *   7J1.10   GPIOX_13      A6      BT_WAKE_HOST
 */
/dts-v1/;
/plugin/;

/ {
	compatible = "libre-computer,aml-s805x-ac",
		"libretech,aml-s805x-ac",
		"libre-computer,aml-s805x-ac-v2",
		"libretech,aml-s805x-ac-v2",
		"amlogic,s805x",
		"amlogic,meson-gxl";

	fragment@0 {
		target-path = "/aliases";

		__overlay__ {
			serial1 = "/soc/cbus@c1100000/serial@84c0";
		};
	};

	fragment@1 {
		target = <&uart_A>;

		__overlay__ {
			status = "okay";
			pinctrl-0 = <&uart_a_pins>;
			pinctrl-names = "default";
		};
	};
};
