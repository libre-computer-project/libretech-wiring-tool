// SPDX-License-Identifier: (GPL-2.0-or-later OR MIT)
/*
 * Copyright (c) 2024 Da Xue
 * Author: Da Xue <da@libre.computer>
 */
/*
 * Summary: DS3231 RTC on I2C_A bus address 0x68
 *
 * Requires: i2c-a
 */
/dts-v1/;
/plugin/;

/ {
	compatible = "libre-computer,aml-s805x-ac",
		"libretech,aml-s805x-ac",
		"libre-computer,aml-s805x-ac-v2",
		"libretech,aml-s805x-ac-v2",
		"amlogic,s805x",
		"amlogic,meson-gxl";

	fragment@1 {
		target = <&i2c_A>;
		
		__overlay__ {
			rtc@68 {
				compatible = "maxim,ds3231";
				reg = <0x68>;
			};
		};
	};
};
