// SPDX-License-Identifier: (GPL-2.0+ OR MIT)
/*
 * Copyright (c) 2024 Da Xue
 * Author: Da Xue <da@libre.computer>
 */

/*
 * Enables UART_A on 40P header 7J1 pins 8 (TX) and 10 (RX) with CLK81 for additional baud rates
 */

/dts-v1/;
/plugin/;

#include <dt-bindings/clock/gxbb-clkc.h>

/ {
	compatible = "libretech,aml-s805x-ac", "amlogic,s805x", "amlogic,meson-gxl";

	fragment@0 {
		target-path = "/aliases";

		__overlay__ {
			serial1 = "/soc/cbus@c1100000/serial@84c0";
		};
	};

	fragment@1 {
		target = <&uart_A>;

		__overlay__ {
			status = "okay";
			pinctrl-0 = <&uart_a_pins>;
			pinctrl-names = "default";
			clocks = <&xtal>, <&clkc CLKID_UART0>, <&clkc CLKID_CLK81>;
			clock-names = "xtal", "pclk", "baud";
		};
	};
};
