// SPDX-License-Identifier: (GPL-2.0-or-later OR MIT)
/*
 * Copyright (c) 2022 Da Xue
 * Author: Da Xue <da@libre.computer>
 */
/*
 * Summary: spi-cc-1cs-st7789v-240x320-fbdev
 *
 * Pins (Header.Pin  Name  Pad  Ref — cross-ref gpio.map):
 *   7J1.22   GPIOX_0       A2      WIFI_D0
 *   7J1.29   GPIODV_27     G3      SYS_LED
 *   7J1.31   GPIOAO_2      B7      PWR_KEY_DET
 *
 * Requires: spi-cc-1cs
 *
 * Notes:
 * Display stack: fbtft/legacy only (CONFIG_FB_TFT / staging/fbtft).
 * Filename uses -fbdev. Not the tinydrm/DRM panel path.
 * Properties tagged "fbtft/legacy" apply to this stack.
 */
/dts-v1/;
/plugin/;

#include <dt-bindings/gpio/gpio.h>
#include <dt-bindings/gpio/meson-gxl-gpio.h>

/ {
	compatible = "libre-computer,aml-s805x-ac",
		"libretech,aml-s805x-ac",
		"libre-computer,aml-s805x-ac-v2",
		"libretech,aml-s805x-ac-v2",
		"amlogic,s805x",
		"amlogic,meson-gxl";

	fragment@0 {
		target = <&spicc>;
		
		__overlay__ {
			st7789v@0 {
				compatible = "sitronix,st7789v";
				reg = <0>;
				led-gpios = <&gpio GPIOX_0 GPIO_ACTIVE_HIGH>;	/* fbtft/legacy */
				dc-gpios = <&gpio GPIODV_27 GPIO_ACTIVE_HIGH>;
				reset-gpios = <&gpio_ao GPIOAO_2 GPIO_ACTIVE_LOW>;
				height = <320>;	/* fbtft/legacy */
				width = <240>;	/* fbtft/legacy */
				rotate = <180>;	/* fbtft/legacy */
				buswidth = <16>;	/* fbtft/legacy */
				spi-cpol;
				spi-cpha;
				spi-max-frequency = <41666666>;
				status = "okay";
			};
		};
	};
};
