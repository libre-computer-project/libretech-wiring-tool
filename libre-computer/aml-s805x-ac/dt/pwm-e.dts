// SPDX-License-Identifier: (GPL-2.0-or-later OR MIT)
/*
 * Copyright (c) 2024 Da Xue
 * Author: Da Xue <da@libre.computer>
 */
/*
 * Summary: PWM E on Header 7J1 Pin 32
 *
 * Pins (Header.Pin  Name  Pad  Ref — cross-ref gpio.map):
 *   7J1.32   GPIOX_16      A3      WIFI_32K
 */
/dts-v1/;
/plugin/;

#include <dt-bindings/clock/gxbb-clkc.h>

/ {
	compatible = "libre-computer,aml-s805x-ac",
		"libretech,aml-s805x-ac",
		"libre-computer,aml-s805x-ac-v2",
		"libretech,aml-s805x-ac-v2",
		"amlogic,s805x",
		"amlogic,meson-gxl";

	fragment@0 {
		target = <&pwm_ef>;
		
		__overlay__ {
			status = "okay";
			pinctrl-0 = <&pwm_e_pins>;
			pinctrl-names = "default";
			clocks = <&clkc CLKID_FCLK_DIV4>;
			clock-names = "clkin0";
		};
	};
};
