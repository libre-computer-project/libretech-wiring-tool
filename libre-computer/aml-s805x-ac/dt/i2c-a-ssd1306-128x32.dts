// SPDX-License-Identifier: (GPL-2.0-or-later OR MIT)
/*
 * Copyright (c) 2024 Da Xue
 * Author: Da Xue <da@libre.computer>
 */
/*
 * Summary: SSD3306 on I2C A
 *
 * Requires: i2c-a
 *
 * Notes:
 * Please update the AML-S805X-AC firmware to the latest version.
 */
/dts-v1/;
/plugin/;

/ {
        compatible = "libre-computer,aml-s805x-ac",
            "libretech,aml-s805x-ac",
            "libre-computer,aml-s805x-ac-v2",
            "libretech,aml-s805x-ac-v2",
            "amlogic,s805x",
            "amlogic,meson-gxl";

        fragment@0 {
                target = <&i2c_A>;

                __overlay__ {
                        ssd1306@3c {
                                compatible = "solomon,ssd1306";
                                reg = <0x3c>;
                                solomon,width = <128>;
                                solomon,height = <32>;
                                solomon,com-invdir;
                                solomon,com-seq;
                                solomon,page-offset = <0>;
                        };
                };
        };
};
