// SPDX-License-Identifier: (GPL-2.0-or-later OR MIT)
/*
 * Copyright (c) 2024 Da Xue
 * Author: Da Xue <da@libre.computer>
 */
/*
 * Summary: I2C0 on 40P header J1 pins 3 (SDA) and 5 (SCL)
 *
 * Pins (Header.Pin  Name  Pad  Ref — cross-ref gpio.map):
 *   J1.3    GPIO2_D1      R17     I2C0_SDA
 *   J1.5    GPIO2_D0      P17     I2C0_SCL
 *
 * Notes:
 *  J1.3    GPIO2_D1      R17     I2C0_SDA
 *  J1.5    GPIO2_D0      P17     I2C0_SCL
 * J1.3    GPIO2_D1      R17     I2C0_SDA
 * J1.5    GPIO2_D0      P17     I2C0_SCL
 */
/dts-v1/;
/plugin/;

/ {
	compatible = "libre-computer,roc-rk3328-cc",
		"libretech,roc-rk3328-cc",
		"libre-computer,roc-rk3328-cc-v2",
		"libretech,roc-rk3328-cc-v2",
		"firefly,roc-rk3328-cc",
		"rockchip,rk3328";

	fragment@0 {
		target = <&i2c0>;
		__overlay__ {
			status = "okay";
		};
	};
};
