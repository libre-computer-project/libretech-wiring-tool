// SPDX-License-Identifier: (GPL-2.0-or-later OR MIT)
/*
 * Copyright (c) 2024 Da Xue
 * Author: Da Xue <da@libre.computer>
 */
/*
 * Summary: UART2 on 40P header J1 pins 36 (TX) and 38 (RX)
 *
 * Pins (Header.Pin  Name  Pad  Ref — cross-ref gpio.map):
 *   J1.36   GPIO2_A0      P19     DEBUG_TX
 *   J1.38   GPIO2_A1      P20     DEBUG_RX
 *
 * Notes:
 *  J1.36   GPIO2_A0      P19     DEBUG_TX
 *  J1.38   GPIO2_A1      P20     DEBUG_RX
 * J1.36   GPIO2_A0      P19     DEBUG_TX
 * J1.38   GPIO2_A1      P20     DEBUG_RX
 */
/dts-v1/;
/plugin/;

/ {
	compatible = "libre-computer,roc-rk3328-cc",
		"libretech,roc-rk3328-cc",
		"libre-computer,roc-rk3328-cc-v2",
		"libretech,roc-rk3328-cc-v2",
		"firefly,roc-rk3328-cc",
		"rockchip,rk3328";

	fragment@0 {
		target = <&uart2>;
		__overlay__ {
			status = "okay";
		};
	};
};
