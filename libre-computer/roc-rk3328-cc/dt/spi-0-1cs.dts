// SPDX-License-Identifier: (GPL-2.0-or-later OR MIT)
/*
 * Copyright (c) 2024 Da Xue
 * Author: Da Xue <da@libre.computer>
 */
/*
 * Summary: SPI on 40P header J1 pins 19 (TX) 21 (RX) 23 (CLK) with chip select on pins 24 (CS0)
 *
 * Pins (Header.Pin  Name  Pad  Ref — cross-ref gpio.map):
 *   J1.19   GPIO3_A1      D2      GPIO3_A1_U/SPI_TXD
 *   J1.21   GPIO3_A2      E1      GPIO3_A2_D/SPI_RXD
 *   J1.23   GPIO3_A0      E3      GPIO3_A0_U/SPI_CLK
 *
 * Notes:
 *  J1.19   GPIO3_A1      D2      GPIO3_A1_U/SPI_TXD
 *  J1.21   GPIO3_A2      E1      GPIO3_A2_D/SPI_RXD
 *  J1.23   GPIO3_A0      E3      GPIO3_A0_U/SPI_CLK
 * J1.19   GPIO3_A1      D2      GPIO3_A1_U/SPI_TXD
 * J1.21   GPIO3_A2      E1      GPIO3_A2_D/SPI_RXD
 * J1.23   GPIO3_A0      E3      GPIO3_A0_U/SPI_CLK
 */
/dts-v1/;
/plugin/;

#include <dt-bindings/gpio/gpio.h>
#include <dt-bindings/pinctrl/rockchip.h>

/ {
	compatible = "libre-computer,roc-rk3328-cc",
		"libretech,roc-rk3328-cc",
		"libre-computer,roc-rk3328-cc-v2",
		"libretech,roc-rk3328-cc-v2",
		"firefly,roc-rk3328-cc",
		"rockchip,rk3328";

	fragment@0 {
		target-path = "/aliases";
		
		__overlay__ {
			spi0 = "/soc/spi@ff190000";
		};
	};

	fragment@1 {
		target = <&spi0>;
		
		__overlay__ {
			status = "okay";
			num-cs = <1>;
		};
	};
};
