// SPDX-License-Identifier: (GPL-2.0-or-later OR MIT)
/*
 * Copyright (c) 2024 Da Xue
 * Author: Da Xue <da@libre.computer>
 */
/*
 * Summary: SPI on 40P header J1 pins 19 (TX) 21 (RX) 23 (CLK) with two chip selects on pins 24 (CS0) 26 (CS1)
 *
 * Pins (Header.Pin  Name  Pad  Ref — cross-ref gpio.map):
 *   J1.19    GPIO3_A1      D2      GPIO3_A1_U/SPI_TXD
 *   J1.21    GPIO3_A2      E1      GPIO3_A2_D/SPI_RXD
 *   J1.23    GPIO3_A0      E3      GPIO3_A0_U/SPI_CLK
 *   J1.24    GPIO3_B0      F3      GPIO3_B0_D/SPI_CSN0
 *   J1.26    GPIO2_B4      T16     GPIO2_B4/SPI_CSN1_M0/FLASH_VOL_SEL
 */
/dts-v1/;
/plugin/;

#include <dt-bindings/gpio/gpio.h>
#include <dt-bindings/pinctrl/rockchip.h>

/ {
	compatible = "libre-computer,roc-rk3328-cc",
		"libretech,roc-rk3328-cc",
		"libre-computer,roc-rk3328-cc-v2",
		"libretech,roc-rk3328-cc-v2",
		"firefly,roc-rk3328-cc",
		"rockchip,rk3328";

	fragment@0 {
		target-path = "/aliases";

		__overlay__ {
			spi0 = "/spi@ff190000";
		};
	};

	fragment@1 {
		target = <&spi0>;

		__overlay__ {
			status = "okay";
			num-cs = <2>;
			/*
			 * Both chip selects are GPIOs. A "pinctrl-1 = <&spi0m0_cs1>"
			 * named "default" a second time was never applied (the
			 * pinctrl core takes the first state of a name), and would
			 * have muxed GPIO2_B4 away from the GPIO cs-gpios needs.
			 */
			cs-gpios = <&gpio3 RK_PB0 GPIO_ACTIVE_LOW>, <&gpio2 RK_PB4 GPIO_ACTIVE_LOW>;
		};
	};
};
