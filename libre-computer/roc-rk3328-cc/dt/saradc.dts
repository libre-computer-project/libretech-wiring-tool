// SPDX-License-Identifier: (GPL-2.0-or-later OR MIT)
/*
 * Copyright (c) 2024 Da Xue
 * Author: Da Xue <da@libre.computer>
 */
/*
 * Summary: SARADC on 3P header J21 pins 1 (IN1) and 3 (IN0)
 *
 * Pins (Header.Pin  Name  Pad  Ref — cross-ref gpio.map):
 *   J1.3    GPIO2_D1      R17     I2C0_SDA
 *
 * Notes:
 *  J1.3    GPIO2_D1      R17     I2C0_SDA
 * J1.3    GPIO2_D1      R17     I2C0_SDA
 * This overlay will not be necessary in the future as it will be integrated with the base tree.
 */
/dts-v1/;
/plugin/;

/ {
	compatible = "libre-computer,roc-rk3328-cc",
		"libretech,roc-rk3328-cc",
		"libre-computer,roc-rk3328-cc-v2",
		"libretech,roc-rk3328-cc-v2",
		"firefly,roc-rk3328-cc",
		"rockchip,rk3328";

	fragment@0 {
		target = <&saradc>;
		__overlay__ {
			vref-supply = <&vcc_18>;
		};
	};
};
