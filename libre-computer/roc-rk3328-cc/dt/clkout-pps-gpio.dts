/*
 * Copyright (c) 2024 Jaime Jackson-Block
 * Author: Jaime Jackson-Block
 * SPDX-License-Identifier: (GPL-2.0+ OR MIT)
 */

/dts-v1/;
/plugin/;

#include <dt-bindings/gpio/gpio.h>
#include <dt-bindings/pinctrl/rockchip.h>

/*
 * 7 1-28 CLKOUT GPIO1_D4
 */

/ {
    compatible = "rockchip,rk3328";

    fragment@0 {
        target-path = "/";

        __overlay__ {
            pps_gpio: pps-gpio {
                compatible = "pps-gpio";
                pinctrl-names = "default";
                gpios = <&gpio1 RK_PD4 GPIO_ACTIVE_HIGH>;
                assert-rising-edge;
                status = "okay";
            };
        };
    };
};
