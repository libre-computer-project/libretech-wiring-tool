// SPDX-License-Identifier: (GPL-2.0-or-later OR MIT)
/*
 * Copyright (c) 2024 Da Xue
 * Author: Da Xue <da@libre.computer>
 */
/*
 * Summary: PWM on 40P header J1 pin 12
 *
 * Pins (Header.Pin  Name  Pad  Ref — cross-ref gpio.map):
 *   J1.12   GPIO2_A6      M19     GPIO2_A6_U/PWM2
 *
 * Notes:
 *  J1.12   GPIO2_A6      M19     GPIO2_A6_U/PWM2
 * J1.12   GPIO2_A6      M19     GPIO2_A6_U/PWM2
 */
/dts-v1/;
/plugin/;

/ {
	compatible = "libre-computer,roc-rk3328-cc",
		"libretech,roc-rk3328-cc",
		"libre-computer,roc-rk3328-cc-v2",
		"libretech,roc-rk3328-cc-v2",
		"firefly,roc-rk3328-cc",
		"rockchip,rk3328";

	fragment@0 {
		target = <&pwm2>;
		__overlay__ {
			status = "okay";
		};
	};
};
