/*
 * Copyright (c) 2024 Da Xue
 * Author: Da Xue <da@libre.computer>
 *
 * SPDX-License-Identifier: (GPL-2.0+ OR MIT)
 */

/*
 * Enables I2C0 on 40P header J1 pins 3 (SDA) and 5 (SCL)
 */

/dts-v1/;
/plugin/;

/ {
	compatible = "libretech,roc-rk3328-cc", "rockchip,rk3328";

	fragment@0 {
		target = <&i2c0>;
		__overlay__ {
			status = "okay";
		};
	};
};
