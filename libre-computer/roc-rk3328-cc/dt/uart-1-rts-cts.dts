// SPDX-License-Identifier: (GPL-2.0-or-later OR MIT)
/*
 * Copyright (c) 2024 Da Xue
 * Author: Da Xue <da@libre.computer>
 */
/*
 * Summary: UART1 on 40P header J1 pins 8 (TX), 10 (RX), 16 (CTS), 18 (RTS)
 *
 * Pins (Header.Pin  Name  Pad  Ref — cross-ref gpio.map):
 *   J1.8     GPIO3_A4      E2      UART1_TX
 *   J1.10    GPIO3_A6      F2      UART1_RX
 *   J1.16    GPIO3_A7      F1      UART1_CTSN
 *   J1.18    GPIO3_A5      D1      UART1_RTSN
 *
 * Resource-provides: bus:uart1
 *
 * Notes:
 * What uart-1 did before it became TX/RX only: the base DTB's uart1
 * pinctrl-0 (xfer + cts + rts), with hardware flow control enabled.
 */
/dts-v1/;
/plugin/;

/ {
	compatible = "libre-computer,roc-rk3328-cc",
		"libretech,roc-rk3328-cc",
		"libre-computer,roc-rk3328-cc-v2",
		"libretech,roc-rk3328-cc-v2",
		"firefly,roc-rk3328-cc",
		"rockchip,rk3328";

	fragment@0 {
		target = <&uart1>;
		__overlay__ {
			status = "okay";
			pinctrl-names = "default";
			pinctrl-0 = <&uart1_xfer &uart1_cts &uart1_rts>;
			uart-has-rtscts;
		};
	};
};
