// SPDX-License-Identifier: (GPL-2.0-or-later OR MIT)
/*
 * Copyright (c) 2024 Da Xue
 * Author: Da Xue <da@libre.computer>
 */
/*
 * Summary: UART1 on 40P header J1 pins 8 (TX) and 10 (RX)
 *
 * Pins (Header.Pin  Name  Pad  Ref — cross-ref gpio.map):
 *   J1.8     GPIO3_A4      E2      UART1_TX
 *   J1.10    GPIO3_A6      F2      UART1_RX
 *
 * Resource-provides: bus:uart1
 *
 * Notes:
 * TX/RX only, like H40P_UART_0 on every other board. The base DTB's uart1
 * pinctrl-0 also muxes CTS/RTS onto pins 16/18; uart-1-rts-cts keeps those.
 */
/dts-v1/;
/plugin/;

/ {
	compatible = "libre-computer,roc-rk3328-cc",
		"libretech,roc-rk3328-cc",
		"libre-computer,roc-rk3328-cc-v2",
		"libretech,roc-rk3328-cc-v2",
		"rockchip,rk3328";

	fragment@0 {
		target = <&uart1>;
		__overlay__ {
			status = "okay";
			pinctrl-names = "default";
			pinctrl-0 = <&uart1_xfer>;
		};
	};
};
