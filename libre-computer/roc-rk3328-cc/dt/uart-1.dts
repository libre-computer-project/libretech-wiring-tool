// SPDX-License-Identifier: (GPL-2.0-or-later OR MIT)
/*
 * Copyright (c) 2024 Da Xue
 * Author: Da Xue <da@libre.computer>
 */
/*
 * Summary: UART1 on 40P header J1 pins 8 (TX) and 10 (RX)
 *
 * Pins (Header.Pin  Name  Pad  Ref — cross-ref gpio.map):
 *   J1.8    GPIO3_A4      E2      UART1_TX
 *   J1.10   GPIO3_A6      F2      UART1_RX
 *
 * Notes:
 *  J1.8    GPIO3_A4      E2      UART1_TX
 *  J1.10   GPIO3_A6      F2      UART1_RX
 * J1.8    GPIO3_A4      E2      UART1_TX
 * J1.10   GPIO3_A6      F2      UART1_RX
 */
/dts-v1/;
/plugin/;

/ {
	compatible = "libre-computer,roc-rk3328-cc",
		"libretech,roc-rk3328-cc",
		"libre-computer,roc-rk3328-cc-v2",
		"libretech,roc-rk3328-cc-v2",
		"firefly,roc-rk3328-cc",
		"rockchip,rk3328";

	fragment@0 {
		target = <&uart1>;
		__overlay__ {
			status = "okay";
		};
	};
};
