// SPDX-License-Identifier: (GPL-2.0-or-later OR MIT)
/*
 * Copyright (c) 2025 Da Xue
 * Author: Da Xue <da@libre.computer>
 */
/*
 * Summary: PWM C on Header 7J1 Pin 33
 *
 * Pins (Header.Pin  Name  Pad  Ref — cross-ref gpio.map):
 *   7J1.33   GPIOX_5       BK38    GPIOX_5
 *
 * Notes:
 * pwm_c on GPIOX_5, pwm_d is potentially used by GPIOX_3 as LED
 */
/dts-v1/;
/plugin/;

/ {
        compatible = "libre-computer,aml-a311d-cc",
            "libretech,aml-a311d-cc",
            "libre-computer,aml-a311d-cc-v01",
            "libretech,aml-a311d-cc-v01",
            "libre-computer,aml-s905d3-cc",
            "libretech,aml-s905d3-cc",
            "libre-computer,aml-s905d3-cc-v01",
            "libretech,aml-s905d3-cc-v01",
            "amlogic,a311d",
            "amlogic,g12b",
            "amlogic,s905d3",
            "amlogic,sm1";

	fragment@0 {
		target = <&pwm_cd>;
		
		__overlay__ {
			status = "okay";
			pinctrl-0 = <&pwm_c_x5_pins>, <&pwm_d_x3_pins>;
			pinctrl-names = "default";
			clocks = <&xtal>;
			clock-names = "clkin1";
		};
	};
};
