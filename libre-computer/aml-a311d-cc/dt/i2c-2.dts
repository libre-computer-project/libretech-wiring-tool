// SPDX-License-Identifier: (GPL-2.0-or-later OR MIT)
/*
 * Copyright (C) 2024 Libre Computer, Inc.
 * Author: Luke Lu <luke.lu@libre.computer>
 */
/*
 * Summary: 40 Header J72 - Pin 27 (SDA), 28 (SCL)
 *
 * Pins (Header.Pin  Name  Pad  Ref — cross-ref gpio.map):
 *   7J1.27   GPIOX_17      BF31    I2C_EE_M2_SDA
 */
/dts-v1/;
/plugin/;

/ {
	compatible = "libre-computer,aml-a311d-cc",
		"libretech,aml-a311d-cc",
		"libre-computer,aml-a311d-cc-v01",
		"libretech,aml-a311d-cc-v01",
		"libre-computer,aml-s905d3-cc",
		"libretech,aml-s905d3-cc",
		"libre-computer,aml-s905d3-cc-v01",
		"libretech,aml-s905d3-cc-v01",
		"amlogic,a311d",
		"amlogic,g12b",
		"amlogic,s905d3",
		"amlogic,sm1";

	fragment@0 {
		target = <&i2c2>;

		__overlay__ {
			status = "okay";
			pinctrl-0 = <&i2c2_sda_x_pins>, <&i2c2_sck_x_pins>;
			pinctrl-names = "default";
		};
	};
};
