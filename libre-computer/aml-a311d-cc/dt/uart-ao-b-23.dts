// SPDX-License-Identifier: (GPL-2.0-or-later OR MIT)
/*
 * Copyright (C) 2024 Libre Computer, Inc.
 * Author: Da Xue <da@libre.computer>
 */
/*
 * Summary: UART_AO_B 40 Header 7J2 pins 5 (TX) and 3 (RX)
 *
 * Pins (Header.Pin  Name  Pad  Ref — cross-ref gpio.map):
 *   7J1.3    GPIOAO_3      BF13    I2C_AO_M0_SDA
 *   7J1.5    GPIOAO_2      AU40    I2C_AO_M0_SCL
 */
/dts-v1/;
/plugin/;

/ {
	compatible = "libre-computer,aml-a311d-cc",
		"libretech,aml-a311d-cc",
		"libre-computer,aml-a311d-cc-v01",
		"libretech,aml-a311d-cc-v01",
		"libre-computer,aml-s905d3-cc",
		"libretech,aml-s905d3-cc",
		"libre-computer,aml-s905d3-cc-v01",
		"libretech,aml-s905d3-cc-v01",
		"amlogic,a311d",
		"amlogic,g12b",
		"amlogic,s905d3",
		"amlogic,sm1";

	fragment@0 {
		target = <&uart_AO_B>;

		__overlay__ {
			status = "okay";
			pinctrl-0 = <&uart_ao_b_2_3_pins>;
			pinctrl-names = "default";
		};
	};
};
