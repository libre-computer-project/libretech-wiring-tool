// SPDX-License-Identifier: (GPL-2.0-or-later OR MIT)
/*
 * Copyright (C) 2024 Libre Computer, Inc.
 * Author: Da Xue <da@libre.computer>
 */
/*
 * Summary: UART_C 40 Header 7J2 pins 23 (TX), 24 (RX), 19 (RTS), and 21 (CTS)
 *
 * Pins (Header.Pin  Name  Pad  Ref — cross-ref gpio.map):
 *   7J1.19   GPIOH_4       W40     SPI_B_MOSI
 *   7J1.21   GPIOH_5       W38     SPI_B_MISO
 *   7J1.23   GPIOH_7       AB38    SPI_B_SCLK
 *   7J1.24   GPIOH_6       H40     SPI_B_SS0
 */
/dts-v1/;
/plugin/;

/ {
	compatible = "libre-computer,aml-a311d-cc",
		"libretech,aml-a311d-cc",
		"libre-computer,aml-a311d-cc-v01",
		"libretech,aml-a311d-cc-v01",
		"libre-computer,aml-s905d3-cc",
		"libretech,aml-s905d3-cc",
		"libre-computer,aml-s905d3-cc-v01",
		"libretech,aml-s905d3-cc-v01",
		"amlogic,a311d",
		"amlogic,g12b",
		"amlogic,s905d3",
		"amlogic,sm1";

	fragment@0 {
		target = <&uart_C>;

		__overlay__ {
			status = "okay";
			pinctrl-0 = <&uart_c_pins>, <&uart_c_cts_rts_pins>;
			pinctrl-names = "default";
			uart-has-rtscts;
		};
	};
};
