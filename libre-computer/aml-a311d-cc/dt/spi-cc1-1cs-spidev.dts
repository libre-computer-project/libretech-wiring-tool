// SPDX-License-Identifier: (GPL-2.0-or-later OR MIT)
/*
 * Copyright (c) 2024 Da Xue
 * Author: Da Xue <da@libre.computer>
 */
/*
 * Summary: SPICC1 userspace spidev for spi-cc1-1cs
 *
 * Requires: spi-cc1-1cs
 */
/dts-v1/;
/plugin/;

#include <dt-bindings/gpio/gpio.h>
#include <dt-bindings/gpio/meson-g12a-gpio.h>

/ {
        compatible = "libre-computer,aml-a311d-cc",
            "libretech,aml-a311d-cc",
            "libre-computer,aml-a311d-cc-v01",
            "libretech,aml-a311d-cc-v01",
            "libre-computer,aml-s905d3-cc",
            "libretech,aml-s905d3-cc",
            "libre-computer,aml-s905d3-cc-v01",
            "libretech,aml-s905d3-cc-v01",
            "amlogic,a311d",
            "amlogic,g12b",
            "amlogic,s905d3",
            "amlogic,sm1";

        fragment@0 {
		target = <&spicc1>;

		__overlay__ {
			spidev@0 {
                                compatible = "rohm,dh2228fv";
				reg = <0>;
				spi-max-frequency = <166666664>;
			};
		};
        };
};

