// SPDX-License-Identifier: (GPL-2.0-or-later OR MIT)
/*
 * Copyright (c) 2025 Da Xue
 * Author: Da Xue <da@libre.computer>
 */
/*
 * Summary: Fan on PWM C a on Header 7J1 Pin 33 with tach on Header 7J1 Pin 35
 *
 * Pins (Header.Pin  Name  Pad  Ref — cross-ref gpio.map):
 *   7J1.33   GPIOX_5       BK38    GPIOX_5
 *   7J1.35   GPIOX_10      BD31    PCM_SYNC
 */
/dts-v1/;
/plugin/;

#include <dt-bindings/gpio/meson-g12a-gpio.h>
#include <dt-bindings/interrupt-controller/irq.h>
#include <dt-bindings/interrupt-controller/amlogic,meson-g12a-gpio-intc.h>

/ {
	compatible = "libre-computer,aml-a311d-cc",
		"libretech,aml-a311d-cc",
		"libre-computer,aml-a311d-cc-v01",
		"libretech,aml-a311d-cc-v01",
		"libre-computer,aml-s905d3-cc",
		"libretech,aml-s905d3-cc",
		"libre-computer,aml-s905d3-cc-v01",
		"libretech,aml-s905d3-cc-v01",
		"amlogic,a311d",
		"amlogic,g12b",
		"amlogic,s905d3",
		"amlogic,sm1";

	fragment@0 {
		target-path = "/";
		__overlay__ {
			fan0: pwm-fan {
				compatible = "pwm-fan";
				pwms = <&pwm_cd 0 25000 0>;
				interrupt-parent = <&gpio_intc>;
				interrupts = <IRQID_GPIOX_10 IRQ_TYPE_EDGE_FALLING>;
				pulses-per-revolution = <2>;
			};
		};
	};
};
