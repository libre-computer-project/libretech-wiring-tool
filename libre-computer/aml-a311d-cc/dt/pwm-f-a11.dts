// SPDX-License-Identifier: (GPL-2.0-or-later OR MIT)
/*
 * Copyright (c) 2025 Da Xue
 * Author: Da Xue <da@libre.computer>
 */
/*
 * Summary: PWM F on Header 7J1 Pin 32
 *
 * Pins (Header.Pin  Name  Pad  Ref — cross-ref gpio.map):
 *   7J1.32   GPIOA_11      G22     GPIOA_11
 *
 * Notes:
 * PWM E on GPIOX_16 is NC, PWM F on GPIOA_11
 */
/dts-v1/;
/plugin/;

/ {
        compatible = "libre-computer,aml-a311d-cc",
            "libretech,aml-a311d-cc",
            "libre-computer,aml-a311d-cc-v01",
            "libretech,aml-a311d-cc-v01",
            "libre-computer,aml-s905d3-cc",
            "libretech,aml-s905d3-cc",
            "libre-computer,aml-s905d3-cc-v01",
            "libretech,aml-s905d3-cc-v01",
            "amlogic,a311d",
            "amlogic,g12b",
            "amlogic,s905d3",
            "amlogic,sm1";

	fragment@0 {
		target = <&pwm_ef>;
		
		__overlay__ {
			status = "okay";
			pinctrl-0 = <&pwm_e_pins>, <&pwm_f_a_pins>;
			pinctrl-names = "default";
			clocks = <&xtal>;
			clock-names = "clkin1";
		};
	};
};
