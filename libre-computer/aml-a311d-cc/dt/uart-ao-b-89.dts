// SPDX-License-Identifier: (GPL-2.0-or-later OR MIT)
/*
 * Copyright (C) 2024 Libre Computer, Inc.
 * Author: Da Xue <da@libre.computer>
 */
/*
 * Summary: UART_AO_B 40 Header 7J2 pins 8 (TX) and 10 (RX)
 *
 * Pins (Header.Pin  Name  Pad  Ref — cross-ref gpio.map):
 *   7J1.8    GPIOAO_8      AT42    GPIOAO_8/JTAG_TDI
 *   7J1.10   GPIOAO_9      AT44    GPIOAO_9/JTAG_TDO
 */
/dts-v1/;
/plugin/;

/ {
	compatible = "libre-computer,aml-a311d-cc",
		"libretech,aml-a311d-cc",
		"libre-computer,aml-a311d-cc-v01",
		"libretech,aml-a311d-cc-v01",
		"libre-computer,aml-s905d3-cc",
		"libretech,aml-s905d3-cc",
		"libre-computer,aml-s905d3-cc-v01",
		"libretech,aml-s905d3-cc-v01",
		"amlogic,a311d",
		"amlogic,g12b",
		"amlogic,s905d3",
		"amlogic,sm1";

	fragment@0 {
		target = <&uart_AO_B>;

		__overlay__ {
			status = "okay";
			pinctrl-0 = <&uart_ao_b_8_9_pins>;
			pinctrl-names = "default";
		};
	};
};
