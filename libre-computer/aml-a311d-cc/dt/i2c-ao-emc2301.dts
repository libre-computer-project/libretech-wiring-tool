// SPDX-License-Identifier: (GPL-2.0+ OR MIT)
/*
 * Copyright (C) 2025 Da Xue
 * Author: Da Xue <da@libre.computer>
 */

/*
 * Overlay to enable EMC2301 fan controller on I2C_AO (Header J72 Pin 3: SDA, Pin 5: SCL)
 * This controller is present on the LoveRPi PoE+ HAT
 */

/dts-v1/;
/plugin/;

#include <dt-bindings/thermal/thermal.h>

/ {
	compatible = "libretech,aml-a311d-cc", "amlogic,a311d", "amlogic,g12b", "libretech,aml-s905d3-cc", "amlogic,s905d3", "amlogic,sm1";

	fragment@0 {
		target = <&i2c_AO>;

		__overlay__ {
			fan_controller: emc2301@2f {
				compatible = "microchip,emc2301";
				reg = <0x2f>;
				status = "okay";
				#address-cells = <1>;
				#size-cells = <0>;
				#pwm-cells = <3>;

				fan0: fan@0 {
					reg = <0>;
					pwms = <&fan_controller 26000 0 0>;
					#cooling-cells = <2>;
				};
			};
		};
	};
};
