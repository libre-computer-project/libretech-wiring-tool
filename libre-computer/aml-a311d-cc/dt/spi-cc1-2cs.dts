// SPDX-License-Identifier: (GPL-2.0-or-later OR MIT)
/*
 * Copyright (c) 2024 Da Xue
 * Author: Da Xue <da@libre.computer>
 */
/*
 * Summary: SPICC1 on Header 7J2 on pins 19 (MOSI), 21 (MISO), 23 (SCLK), and 24 (SS0)
 *
 * Pins (Header.Pin  Name  Pad  Ref — cross-ref gpio.map):
 *   7J1.19   GPIOH_4       W40     SPI_B_MOSI
 *   7J1.21   GPIOH_5       W38     SPI_B_MISO
 *   7J1.23   GPIOH_7       AB38    SPI_B_SCLK
 *   7J1.24   GPIOH_6       H40     SPI_B_SS0
 *   7J1.26   GPIOA_9       C15     GPIOA_9
 */
/dts-v1/;
/plugin/;

#include <dt-bindings/gpio/gpio.h>
#include <dt-bindings/gpio/meson-g12a-gpio.h>

/ {
        compatible = "libre-computer,aml-a311d-cc",
            "libretech,aml-a311d-cc",
            "libre-computer,aml-a311d-cc-v01",
            "libretech,aml-a311d-cc-v01",
            "libre-computer,aml-s905d3-cc",
            "libretech,aml-s905d3-cc",
            "libre-computer,aml-s905d3-cc-v01",
            "libretech,aml-s905d3-cc-v01",
            "amlogic,a311d",
            "amlogic,g12b",
            "amlogic,s905d3",
            "amlogic,sm1";

        fragment@0 {
                target-path = "/aliases";

                __overlay__ {
                        spi1 = "/soc/bus@ffd00000/spi@15000";
                };
        };

        fragment@1 {
                target = <&spicc1>;

                __overlay__ {
                        status = "okay";
                        pinctrl-0 = <&spicc1_pins>, <&spicc1_ss0_pins>;
                        pinctrl-names = "default", "default";

                        cs-gpios = <&gpio GPIOH_6 GPIO_ACTIVE_LOW>, <&gpio GPIOA_9 GPIO_ACTIVE_LOW>;
                };
        };
};

