// SPDX-License-Identifier: (GPL-2.0-or-later OR MIT)
/*
 * Copyright (c) 2023 Da Xue <da@libre.computer>
 * Author: Da Xue <da@libre.computer>
 */
/*
 * Summary: cpu-l-opp-2208
 */
/dts-v1/;
/plugin/;

/ {
	compatible = "libre-computer,aml-a311d-cc",
		"libretech,aml-a311d-cc",
		"libre-computer,aml-a311d-cc-v01",
		"libretech,aml-a311d-cc-v01",
		"amlogic,a311d",
		"amlogic,g12b";

	fragment@0 {
		target = <&cpu_opp_table_0>;

		__overlay__ {
			opp-2208000000 {
				opp-hz = /bits/ 64 <2208000000>;
				opp-microvolt = <1011000>;
			};
		};
	};
};

