// SPDX-License-Identifier: (GPL-2.0-or-later OR MIT)
/*
 * Copyright (c) 2025 Da Xue
 * Author: Da Xue <da@libre.computer>
 */
/*
 * Summary: PWM AO C on Header 7J1 Pin 7
 *
 * Pins (Header.Pin  Name  Pad  Ref — cross-ref gpio.map):
 *   7J1.7    GPIOAO_6      AV44    GPIOAO_6/JTAG_CLK
 *
 * Notes:
 * pwm_AO_d is already active in the base tree, so we must re-define pinctrl-0
 * This overlay can only be merged and not enabled since it is already probed.
 */
/dts-v1/;
/plugin/;

/ {
        compatible = "libre-computer,aml-a311d-cc",
            "libretech,aml-a311d-cc",
            "libre-computer,aml-a311d-cc-v01",
            "libretech,aml-a311d-cc-v01",
            "libre-computer,aml-s905d3-cc",
            "libretech,aml-s905d3-cc",
            "libre-computer,aml-s905d3-cc-v01",
            "libretech,aml-s905d3-cc-v01",
            "amlogic,a311d",
            "amlogic,g12b",
            "amlogic,s905d3",
            "amlogic,sm1";

	fragment@0 {
		target = <&pwm_AO_cd>;
		
		__overlay__ {
			status = "okay";
			pinctrl-0 = <&pwm_ao_c_6_pins>, <&pwm_ao_d_e_pins>;
			pinctrl-names = "default";
		};
	};
};
