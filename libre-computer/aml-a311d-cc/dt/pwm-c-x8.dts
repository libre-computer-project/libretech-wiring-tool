// SPDX-License-Identifier: (GPL-2.0-or-later OR MIT)
/*
 * Copyright (c) 2025 Da Xue
 * Author: Da Xue <da@libre.computer>
 */
/*
 * Summary: PWM C on Header 7J1 Pin 38
 *
 * Pins (Header.Pin  Name  Pad  Ref — cross-ref gpio.map):
 *   7J1.38   GPIOX_8       BB34    PCM_DIN
 *
 * Resource-provides: bus:pwm_cd
 *
 * Notes:
 * pwm_c on GPIOX_8. pwm_d's pin, GPIOX_3, is left alone: the base DTB drives
 * the green status LED on it as a gpio-led, and muxing it to PWM_D (as this
 * once did) took the LED off its GPIO.
 */
/dts-v1/;
/plugin/;

/ {
	compatible = "libre-computer,aml-a311d-cc",
		"libretech,aml-a311d-cc",
		"libre-computer,aml-a311d-cc-v01",
		"libretech,aml-a311d-cc-v01",
		"libre-computer,aml-s905d3-cc",
		"libretech,aml-s905d3-cc",
		"libre-computer,aml-s905d3-cc-v01",
		"libretech,aml-s905d3-cc-v01",
		"amlogic,a311d",
		"amlogic,g12b",
		"amlogic,s905d3",
		"amlogic,sm1";

	fragment@0 {
		target = <&pwm_cd>;

		__overlay__ {
			status = "okay";
			pinctrl-0 = <&pwm_c_x8_pins>;
			pinctrl-names = "default";
		};
	};
};
