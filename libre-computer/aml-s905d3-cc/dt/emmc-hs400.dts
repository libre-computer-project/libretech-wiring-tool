// SPDX-License-Identifier: (GPL-2.0-or-later OR MIT)
/*
 * eMMC HS400 (200 MHz DDR, ~400 MB/s) for AML-S905D3-CC.
 *
 * !!! REQUIRES THE ON-BOARD SPI NOR TO BE PHYSICALLY DE-POPULATED !!!
 *
 * The NOR (GD25LQ128E, 1.8 V) shares eMMC 8-bit data lines d4/d5/d6
 * (BOOT_4/5/6 = nor_d/q/c). Even deselected (CS# driven high), its ~6 pF pad
 * capacitance on those lines slows the host's HS400 write edges (400 MHz DDR)
 * enough that the card samples them wrong -- SILENT write corruption: reads
 * tune with a wide eye and 0 CRC, but writes commit wrong data with no CRC
 * flagged. HS200 (200 MHz SDR) tolerates the load; HS400 does not. This is a
 * hardware-only defect (confirmed on aml-s905d3-cc-demo-alpha, 2026-07-07) --
 * no software/firmware lever exists. De-populating the NOR frees d4/d5/d6 for
 * the eMMC (SPI-NOR boot is lost; the board can still boot from SD/eMMC).
 * Full analysis: amlogic/software/kernel/emmc-hs400-plan.md.
 *
 * ALSO REQUIRES kernel HS400 driver support that mainline does NOT have:
 * meson-gx-mmc.c disables HS400 (mmc->caps2 &= ~MMC_CAP2_HS400). The DS/DLL +
 * fixadj eye-tuning port lives on the topic/hs400 branch (untested; a
 * strobe-teardown bug bricked a board on 2026-06-25 and its fix is unvalidated).
 * This DT property is necessary but NOT sufficient without that port landed.
 *
 * The eMMC data-strobe pins (emmc_ds_pins) are already muxed in the base DTS
 * (meson-libretech-cottonwood.dtsi), so only the cap property is added here.
 */

/dts-v1/;
/plugin/;

/ {
	compatible = "libretech,aml-s905d3-cc", "amlogic,sm1";

	fragment@0 {
		target = <&sd_emmc_c>;

		__overlay__ {
			mmc-hs400-1_8v;
		};
	};
};
