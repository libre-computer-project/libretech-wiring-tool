// SPDX-License-Identifier: (GPL-2.0+ OR MIT)
/*
 * eMMC HS400 Enhanced Strobe (HS400-ES) for AML-S905D3-CC.
 *
 * HS400 with the device-driven data strobe used for CMD/response as well as
 * data, removing per-command tuning. Enhanced strobe (EXT_CSD BUS_WIDTH bit 7)
 * is defined ONLY for an 8-bit DDR bus per JEDEC; the eMMC must also report
 * STROBE_SUPPORT (EXT_CSD[184]).
 *
 * !!! REQUIRES THE ON-BOARD SPI NOR TO BE PHYSICALLY DE-POPULATED !!!
 *
 * Same hardware constraint as plain HS400 (emmc-hs400.dts): the NOR
 * (GD25LQ128E, 1.8 V) shares eMMC data lines d4/d5/d6 and its ~6 pF pad load
 * silently corrupts 8-bit HS400 writes at 400 MHz DDR. Because HS400-ES is
 * 8-bit-only, the 4-bit "dodge the NOR" fallback is not even an option -- the
 * card rejects DDR_BUS_WIDTH_4 | STROBE (err -EBADMSG). The NOR must be
 * de-populated so d4/d5/d6 are eMMC-only. See amlogic/software/kernel/
 * emmc-hs400-plan.md.
 *
 * ALSO REQUIRES kernel HS400 driver support that mainline lacks (HS400 is
 * disabled in meson-gx-mmc.c; the DS/DLL + fixadj-tuning + ES port lives on the
 * topic/hs400 branch, untested, with an unvalidated strobe-teardown brick fix).
 * This DT property is necessary but NOT sufficient without that port landed.
 *
 * The eMMC data-strobe pins (emmc_ds_pins) are already muxed in the base DTS.
 * Apply this OR emmc-hs400.dts, not both.
 */

/dts-v1/;
/plugin/;

/ {
	compatible = "libretech,aml-s905d3-cc", "amlogic,sm1";

	fragment@0 {
		target = <&sd_emmc_c>;

		__overlay__ {
			mmc-hs400-1_8v;
			mmc-hs400-enhanced-strobe;
		};
	};
};
