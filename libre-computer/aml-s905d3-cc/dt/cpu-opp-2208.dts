// SPDX-License-Identifier: (GPL-2.0-or-later OR MIT)
/*
 * Copyright (c) 2023 Da Xue <da@libre.computer>
 * Author: Da Xue <da@libre.computer>
 */
/*
 * Summary: cpu-opp-2208
 */
/dts-v1/;
/plugin/;

/ {
	compatible = "libre-computer,aml-s905d3-cc",
		"libretech,aml-s905d3-cc",
		"libre-computer,aml-s905d3-cc-v01",
		"libretech,aml-s905d3-cc-v01",
		"amlogic,s905d3",
		"amlogic,sm1";

	fragment@0 {
		target = <&cpu_opp_table>;

		__overlay__ {
			opp-2208000000 {
				opp-hz = /bits/ 64 <2208000000>;
				opp-microvolt = <1011000>;
			};
		};
	};
};

